/*
 * FLProg_WebUI — allocation-free channel model.
 *
 * This header intentionally has no HTTP, Wi-Fi or dependency on
 * FLProg_Network. A transport adapter is an optional later layer.
 */
#pragma once

#include <Arduino.h>
#include <stdint.h>
#include <string.h>

#ifndef FLPROG_WEBUI_RUNTIME_VERSION
#define FLPROG_WEBUI_RUNTIME_VERSION "1.6.3-20261024"
#endif

// WPA2 passwords may contain up to 63 characters. Keep one terminating byte
// in every text slot so a write-only Wi-Fi/AP credential is never truncated.
#ifndef FLPROG_WEBUI_TEXT_BYTES
#define FLPROG_WEBUI_TEXT_BYTES 64U
#endif

enum FLProgWebUiValueType : uint8_t { FLPROG_WEBUI_BOOL, FLPROG_WEBUI_INT32, FLPROG_WEBUI_FLOAT, FLPROG_WEBUI_TEXT };
enum FLProgWebUiDirection : uint8_t { FLPROG_WEBUI_PUBLISH, FLPROG_WEBUI_COMMAND, FLPROG_WEBUI_DUPLEX };

struct FLProgWebUiChannelDescriptor {
    const char *id;
    FLProgWebUiValueType type;
    FLProgWebUiDirection direction;
    // Stable external number shown by the editor and used by FLProg blocks.
    // Descriptor array position remains an internal storage detail, allowing
    // API channels 0…100 and user channels 101+ without empty RAM slots.
    uint8_t fbdIndex;
};
struct FLProgWebUiBindingDescriptor {
    const char *role;
    const char *channel;
    const char *direction;
};
struct FLProgWebUiWidgetDescriptor {
    const char *id;
    const char *type;
    const char *label;
    const char *channel;
    const char *icon;
    const char *color;
    const char *size;
    float minimum;
    float maximum;
    float step;
    uint8_t x;
    uint8_t y;
    uint8_t width;
    uint8_t height;
    // Stable page identifier emitted by the project package. Kept last so
    // descriptors generated by earlier editor versions remain source-compatible.
    const char *page;
    // Optional semicolon-separated choices for the select widget. It remains
    // trailing so descriptors from older generated project packages compile.
    const char *options;
    // Optional project-owned HTML display template. The runtime treats it as
    // data and exposes only {{label}}, {{value}} and {{icon}} placeholders.
    const char *code;
    // Optional project generated bindings. Kept trailing for old packages.
    const FLProgWebUiBindingDescriptor *bindings;
    uint8_t bindingCount;
};

// Page labels are project data.  Keep them separate from widgets so device
// navigation never exposes technical IDs such as "main" or "wifi".
struct FLProgWebUiPageDescriptor {
    const char *id;
    const char *title;
};

// Theme data belongs to a project descriptor, never to FLProg_Network.
// Values are compact CSS colour literals (normally #RRGGBB) emitted by the
// editor and used only when the browser renders the generated page.
struct FLProgWebUiThemeDescriptor {
    const char *background;
    const char *card;
    const char *text;
    const char *accent;
};

// Fixed-size slots make loop-time memory use deterministic on ESP8266.
struct FLProgWebUiChannelSlot {
    bool pending;
    // Monotonic revision of this slot.  It lets the HTTP adapter return only
    // changed values after the browser has received its initial page snapshot.
    uint16_t revision;
    union { bool booleanValue; int32_t intValue; float floatValue; char text[FLPROG_WEBUI_TEXT_BYTES]; } value;
};

class FLProgWebUiModel {
public:
    FLProgWebUiModel(const FLProgWebUiChannelDescriptor *channels, FLProgWebUiChannelSlot *slots, uint8_t count)
        : _channels(channels), _slots(slots), _count(count), _revision(0) { if (_slots) memset(_slots, 0, sizeof(FLProgWebUiChannelSlot) * _count); }

    uint8_t count() const { return _count; }
    const FLProgWebUiChannelDescriptor *descriptor(uint8_t index) const { return index < _count ? &_channels[index] : nullptr; }
    int16_t fbdSlot(uint8_t number) const {
        for (uint8_t i=0; i<_count; ++i) if (_channels[i].fbdIndex == number) return i;
        return -1;
    }

    bool publishBool(uint8_t index, bool value) { if (!valid(index, FLPROG_WEBUI_BOOL)) return false; if (_slots[index].value.booleanValue != value) { _slots[index].value.booleanValue = value; touch(index); } return true; }
    bool publishInt(uint8_t index, int32_t value) { if (!valid(index, FLPROG_WEBUI_INT32)) return false; if (_slots[index].value.intValue != value) { _slots[index].value.intValue = value; touch(index); } return true; }
    bool publishFloat(uint8_t index, float value) { if (!valid(index, FLPROG_WEBUI_FLOAT)) return false; if (_slots[index].value.floatValue != value) { _slots[index].value.floatValue = value; touch(index); } return true; }
    bool publishText(uint8_t index, const char *value) { if (!valid(index, FLPROG_WEBUI_TEXT)) return false; const char *source = value ? value : ""; if (strcmp(_slots[index].value.text, source) != 0) { strncpy(_slots[index].value.text, source, sizeof(_slots[index].value.text)-1); _slots[index].value.text[sizeof(_slots[index].value.text)-1] = 0; touch(index); } return true; }

    // Used only by a future transport after validating an incoming command.
    bool queueBool(uint8_t index, bool value) { if (!valid(index, FLPROG_WEBUI_BOOL)) return false; _slots[index].value.booleanValue=value; _slots[index].pending=true; return true; }
    bool takeBool(uint8_t index, bool &value) { if (!pending(index, FLPROG_WEBUI_BOOL)) return false; value=_slots[index].value.booleanValue; _slots[index].pending=false; return true; }
    bool queueInt(uint8_t index, int32_t value) { if (!valid(index, FLPROG_WEBUI_INT32)) return false; _slots[index].value.intValue=value; _slots[index].pending=true; return true; }
    bool takeInt(uint8_t index, int32_t &value) { if (!pending(index, FLPROG_WEBUI_INT32)) return false; value=_slots[index].value.intValue; _slots[index].pending=false; return true; }
    bool queueFloat(uint8_t index, float value) { if (!valid(index, FLPROG_WEBUI_FLOAT)) return false; _slots[index].value.floatValue=value; _slots[index].pending=true; return true; }
    bool takeFloat(uint8_t index, float &value) { if (!pending(index, FLPROG_WEBUI_FLOAT)) return false; value=_slots[index].value.floatValue; _slots[index].pending=false; return true; }
    bool queueText(uint8_t index, const char *value) { if (!publishText(index, value)) return false; _slots[index].pending=true; return true; }
    bool takeText(uint8_t index, char *out, uint8_t outSize) { if (!pending(index, FLPROG_WEBUI_TEXT) || !out || outSize == 0) return false; strncpy(out, _slots[index].value.text, outSize-1); out[outSize-1]=0; _slots[index].pending=false; return true; }

    int16_t indexOf(const char *id) const {
        if (!id) return -1;
        for (uint8_t i=0; i<_count; ++i) if (_channels[i].id && strcmp(_channels[i].id, id) == 0) return i;
        return -1;
    }
    FLProgWebUiValueType typeAt(uint8_t index) const { return index < _count ? _channels[index].type : FLPROG_WEBUI_TEXT; }
    FLProgWebUiDirection directionAt(uint8_t index) const { return index < _count ? _channels[index].direction : FLPROG_WEBUI_PUBLISH; }
    bool boolAt(uint8_t index) const { return index < _count && _slots[index].value.booleanValue; }
    int32_t intAt(uint8_t index) const { return index < _count ? _slots[index].value.intValue : 0; }
    float floatAt(uint8_t index) const { return index < _count ? _slots[index].value.floatValue : 0.0f; }
    const char *textAt(uint8_t index) const { return index < _count ? _slots[index].value.text : ""; }
    uint16_t revision() const { return _revision; }
    bool changedSince(uint8_t index, uint16_t revision) const { return index < _count && _slots[index].revision != 0 && _slots[index].revision > revision; }

private:
    bool valid(uint8_t index, FLProgWebUiValueType type) const { return index < _count && _channels[index].type == type; }
    bool pending(uint8_t index, FLProgWebUiValueType type) const { return valid(index, type) && _slots[index].pending; }
    void touch(uint8_t index) { if (++_revision == 0) ++_revision; _slots[index].revision = _revision; }
    const FLProgWebUiChannelDescriptor *_channels;
    FLProgWebUiChannelSlot *_slots;
    uint8_t _count;
    uint16_t _revision;
};

class FLProgWebUiRuntime {
public:
    static bool configure(FLProgWebUiModel &model) { active() = &model; return true; }
    // Compatibility overload: descriptors generated after Web UI 1.0 can
    // register their theme even when an older imported UBI still constructs
    // the HTTP adapter with its three-argument constructor.
    static bool configure(FLProgWebUiModel &model, const FLProgWebUiThemeDescriptor &theme) { active() = &model; activeTheme() = &theme; return true; }
    static bool configured() { return active() != nullptr; }
    static FLProgWebUiModel *model() { return active(); }
    static const FLProgWebUiThemeDescriptor *theme() { return activeTheme(); }
    static bool publishBool(uint8_t channel, bool value) { const int16_t slot=active()?active()->fbdSlot(channel):-1; return slot>=0 && active()->publishBool((uint8_t)slot, value); }
    static bool publishInt(uint8_t channel, int32_t value) { const int16_t slot=active()?active()->fbdSlot(channel):-1; return slot>=0 && active()->publishInt((uint8_t)slot, value); }
    static bool publishFloat(uint8_t channel, float value) { const int16_t slot=active()?active()->fbdSlot(channel):-1; return slot>=0 && active()->publishFloat((uint8_t)slot, value); }
    static bool publishText(uint8_t channel, const char *value) { const int16_t slot=active()?active()->fbdSlot(channel):-1; return slot>=0 && active()->publishText((uint8_t)slot, value); }
    static bool takeBool(uint8_t channel, bool &value) { const int16_t slot=active()?active()->fbdSlot(channel):-1; return slot>=0 && active()->takeBool((uint8_t)slot, value); }
    static bool takeInt(uint8_t channel, int32_t &value) { const int16_t slot=active()?active()->fbdSlot(channel):-1; return slot>=0 && active()->takeInt((uint8_t)slot, value); }
    static bool takeFloat(uint8_t channel, float &value) { const int16_t slot=active()?active()->fbdSlot(channel):-1; return slot>=0 && active()->takeFloat((uint8_t)slot, value); }
    // String conversion occurs only when a queued text command is consumed.
    // The channel model itself remains fixed-size and allocation-free.
    static bool takeText(uint8_t channel, String &value) {
        char buffer[FLPROG_WEBUI_TEXT_BYTES];
        const int16_t slot=active()?active()->fbdSlot(channel):-1;
        if (slot < 0 || !active()->takeText((uint8_t)slot, buffer, sizeof(buffer))) return false;
        value = buffer;
        return true;
    }
private:
    static FLProgWebUiModel *&active() { static FLProgWebUiModel *instance = nullptr; return instance; }
    static const FLProgWebUiThemeDescriptor *&activeTheme() { static const FLProgWebUiThemeDescriptor *instance = nullptr; return instance; }
};
