/*
 * Bounded-response Web UI transport for FLProg_Network.
 *
 * A page is intentionally composed of small responses: metadata, one widget,
 * one channel state and one scan record. This is essential on ESP8266 where
 * FLProgNetworkHttpServer has a fixed response queue. The adapter uses only
 * public FLProg_Network APIs and can serve the same UI through STA and SoftAP.
 */
#pragma once

#include <flprogNetwork.h>
#include "FLProgWebUiGzipHttp.h"
#include "FLProgWebUiBundle.h"
#include "../FLProgWebUiHttpProtocol.h"
#include "../FLProgWebUiPattern.h"
#include "../FLProgWebUiPlatformDiagnostics.h"

#ifndef FLPROG_WEBUI_FLPROG_HTTP_BUFFER_SIZE
#define FLPROG_WEBUI_FLPROG_HTTP_BUFFER_SIZE 1024U
#endif

// ESP8266 has only 32 KiB of user IRAM.  HTTP handlers run from the normal
// cooperative loop (never from an ISR), therefore their code is safe in flash.
// Keeping the large JSON and page-generation routines there is important when
// a FLProg project also uses Wi-Fi, OTA and several generated blocks.
#if defined(ESP8266)
// Do not use ICACHE_FLASH_ATTR in a header: its ESP8266-core implementation
// embeds __FILE__ into the assembler section name, while Windows paths contain
// backslashes and break the assembler. A stable explicit IROM section is safe
// here because these functions are only entered from the cooperative loop.
#define FLPROG_WEBUI_HTTP_STRINGIFY_INNER(value) #value
#define FLPROG_WEBUI_HTTP_STRINGIFY(value) FLPROG_WEBUI_HTTP_STRINGIFY_INNER(value)
// Every function needs its own section: GCC rejects one common IROM section
// when it would otherwise contain methods with incompatible section flags.
#define FLPROG_WEBUI_HTTP_FLASH __attribute__((section(".irom0.text.flpwebui." FLPROG_WEBUI_HTTP_STRINGIFY(__COUNTER__))))
#else
#define FLPROG_WEBUI_HTTP_FLASH
#endif

class FLProgWebUiFlprogNetworkPagedHttp {
public:
    FLProgWebUiFlprogNetworkPagedHttp(FLProgWebUiModel &model, const FLProgWebUiWidgetDescriptor *widgets, uint8_t count)
        : model(model), api(model), widgets(widgets), widgetCount(count), pages(0), pageCount(0), theme(defaultTheme()), network(0), settingsLoaded(false), apSettingsLoaded(false) {}

    FLProgWebUiFlprogNetworkPagedHttp(FLProgWebUiModel &model, const FLProgWebUiWidgetDescriptor *widgets, uint8_t count, const FLProgWebUiThemeDescriptor &theme)
        : model(model), api(model), widgets(widgets), widgetCount(count), pages(0), pageCount(0), theme(theme), network(0), settingsLoaded(false), apSettingsLoaded(false) {}

    FLProgWebUiFlprogNetworkPagedHttp(FLProgWebUiModel &model, const FLProgWebUiWidgetDescriptor *widgets, uint8_t count, const FLProgWebUiPageDescriptor *pages, uint8_t pageCount, const FLProgWebUiThemeDescriptor &theme)
        : model(model), api(model), widgets(widgets), widgetCount(count), pages(pages), pageCount(pageCount), theme(theme), network(0), settingsLoaded(false), apSettingsLoaded(false) {}

    void setPolling(uint32_t intervalMs, bool pauseWhenHidden = true)
    {
        _pollIntervalMs = intervalMs < 500 ? 500 : (intervalMs > 60000 ? 60000 : intervalMs);
        _pauseWhenHidden = pauseWhenHidden;
    }

    bool FLPROG_WEBUI_HTTP_FLASH begin(FLProgNetworkInterface &value, uint16_t port = 80)
    {
        if (active()) return false;
        server.setBrowserHeaderCompatibility(true);
        // A shared SoftAP listener is supported only when the primary HTTP
        // server owns one client slot. The browser therefore sends requests
        // serially; this also avoids exhausting ESP8266 sockets.
        if (!server.begin(value, port, FLPROG_NETWORK_ROUTE_DEFAULT, 1)) return false;
        network = &value;
        active() = this;

        const FLProgNetworkPlatformCapabilities caps = FLProgNetworkInterface::platformCapabilities();
        if (caps.wifiApCompiled && !server.addSharedListener(value, FLPROG_NETWORK_ROUTE_WIFI_AP))
        {
            end();
            return false;
        }

        // The paged UI stays within the 14-route FLProg_Network budget while
        // keeping each response below the bounded HTTP response buffer.
        // Page zero includes metadata; every descriptor remains a small response.
        const bool ready =
            server.addHandler("/", index, FLPROG_WEB_SERVER_GET) &&
            server.addHandler("/flprog-webui/app.css", css, FLPROG_WEB_SERVER_GET) &&
            server.addHandler("/flprog-webui/scan.js", scanScript, FLPROG_WEB_SERVER_GET) &&
            server.addHandler("/flprog-webui/controls.js", controlScript, FLPROG_WEB_SERVER_GET) &&
            server.addHandler("/flprog-webui/widgets.js", widgetScript, FLPROG_WEB_SERVER_GET) &&
            server.addHandler("/flprog-webui/elements.js", elementScript, FLPROG_WEB_SERVER_GET) &&
            server.addHandler("/flprog-webui/boot-view.js", bootViewScript, FLPROG_WEB_SERVER_GET) &&
            server.addHandler("/flprog-webui/boot.js", bootScript, FLPROG_WEB_SERVER_GET) &&
            server.addHandler("/flprog-webui/boot-init.js", bootInitScript, FLPROG_WEB_SERVER_GET) &&
            server.addHandler("/flprog-webui/item", item, FLPROG_WEB_SERVER_GET) &&
            server.addHandler("/flprog-webui/state", state, FLPROG_WEB_SERVER_GET) &&
            server.addHandler("/flprog-webui/scan", scan, FLPROG_WEB_SERVER_GET) &&
            server.addHandler("/flprog-webui/scan/start", scanStart, FLPROG_WEB_SERVER_POST) &&
            server.addHandler("/flprog-webui/write", write, FLPROG_WEB_SERVER_POST);
        if (!ready) end();
        return ready;
    }

    void FLPROG_WEBUI_HTTP_FLASH end()
    {
        server.end();
        if (active() == this) active() = 0;
        network = 0;
    }

private:
    class Json {
    public:
        Json(char *data, size_t size) : data(data), size(size), at(0), valid(data && size)
        {
            if (valid) data[0] = 0;
        }
        bool good() const { return valid; }
        void character(char value)
        {
            if (!valid || at + 1 >= size) { valid = false; return; }
            data[at++] = value;
            data[at] = 0;
        }
        void text(const char *value) { while (value && *value) character(*value++); }
        void string(const char *value)
        {
            character('"');
            for (; value && *value; ++value)
            {
                if (*value == '"' || *value == '\\') character('\\');
                if ((unsigned char)*value < 32) character(' '); else character(*value);
            }
            character('"');
        }
        void unsignedNumber(unsigned value) { char result[12]; snprintf(result, sizeof(result), "%u", value); text(result); }
        void signedNumber(int32_t value) { char result[16]; snprintf(result, sizeof(result), "%ld", (long)value); text(result); }
        // STM32 nano printf does not enable %f by default. dtostrf is provided
        // by the Arduino core and keeps JSON valid without linker float flags.
        void decimal(float value) { if (!isfinite(value)) { text("null"); return; } char result[64]; dtostrf(value, 1, 3, result); text(result); }
    private:
        char *data;
        size_t size;
        size_t at;
        bool valid;
    };

    static FLProgWebUiFlprogNetworkPagedHttp *&active()
    {
        static FLProgWebUiFlprogNetworkPagedHttp *instance = 0;
        return instance;
    }

    static void FLPROG_WEBUI_HTTP_FLASH sendJson(FLProgNetworkHttpServer *value, Json &json)
    {
        if (!json.good()) value->send(507, "application/json", "{\"error\":\"item too large\"}");
        else value->send(200, "application/json", active()->buffer);
    }

    static void FLPROG_WEBUI_HTTP_FLASH index(FLProgNetworkHttpServer *value)
    {
                                                                                                                                                                        #if FLPROG_WEBUI_GZIP_ASSETS
        static const unsigned char assetGzip[] PROGMEM = {0x1f, 0x8b, 0x08, 0x00, 0x00, 0x00, 0x00, 0x00, 0x02, 0xff, 0x65, 0x54, 0xdb,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 0x00, 0x00};
        static_assert(sizeof(assetGzip) + 192U <= FLPROG_HTTP_SERVER_MAX_RESPONSE_BYTES, "gzip response budget");
        flprogWebUiSendGzip(value, "text/html; charset=utf-8", assetGzip, sizeof(assetGzip));
#else
        static const char asset[] PROGMEM =
            "<!doctype html><meta charset=utf-8><meta name=viewport content='width=device-width,initial-scale=1'><style>.el{background:transparent;border:0;border-radius:0;padding:4px 0}.el.head h1{margin:0;font-size:28px}.el.txt{color:#d6e2f4}.el.div hr{border:0;border-top:1px solid #34465f}.el.lnk a{color:#a78bfa}.el.row{display:flex;justify-content:space-between;border-bottom:1px solid #34465f;padding:7px 0}.el.row b{font-weight:800}</style><main><nav id=n></nav><div id=s role=status>Загрузка интерфейса: 0%</div></main><div id=m hidden></div><script>var bootStarted=Date.now();async function bootRead(u,cache='no-store'){for(let i=0;i<3;i++){if(typeof pauseHidden==='boolean'&&pauseHidden&&document.hidden&&u.startsWith('/flprog-webui/state'))throw Error('Опрос приостановлен');let c=new AbortController(),timer=setTimeout(()=>c.abort(),2500);try{let r=await fetch(u,{signal:c.signal,cache});if(!r.ok){let e=Error('HTTP '+r.status);e.retry=r.status>=500||r.status===408||r.status===429;throw e}return await r.text()}catch(e){if(e.retry===false||i===2)throw e}finally{clearTimeout(timer)}await new Promise(r=>setTimeout(r,150*(i+1)))}}(async()=>{try{let e=document.createElement('script');e.textContent=await bootRead('/flprog-webui/controls.js?part=loader&v=webui175-0ad879ed016f','default');document.head.append(e)}catch(e){document.querySelector('#s').textContent='Не удалось загрузить интерфейс: '+e.message+'. Обновите страницу.'}})()</script>";
        static_assert(sizeof(asset) - 1U + 128U <= FLPROG_HTTP_SERVER_MAX_RESPONSE_BYTES,
            "FLProg WebUI: index exceeds HTTP response budget");
        flprogWebUiSendIdentity(value, "text/html; charset=utf-8", asset);
#endif // FLPROG_WEBUI_GZIP_ASSETS
    }

    static void FLPROG_WEBUI_HTTP_FLASH css(FLProgNetworkHttpServer *value)
    {
                                                                                                                                                                        #if FLPROG_WEBUI_GZIP_ASSETS
        static const unsigned char assetGzip[] PROGMEM = {0x1f, 0x8b, 0x08, 0x00, 0x00, 0x00, 0x00, 0x00, 0x02, 0xff, 0x95, 0x54, 0xe1,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 0x00, 0x00};
        static_assert(sizeof(assetGzip) + 192U <= FLPROG_HTTP_SERVER_MAX_RESPONSE_BYTES, "gzip response budget");
        flprogWebUiSendGzip(value, "text/css", assetGzip, sizeof(assetGzip));
#else
        static const char asset[] PROGMEM =
            ":root{--bg:#0b1120;--card:#162237;--accent:#7367ff;--line:#7186a8}*{box-sizing:border-box}body{margin:0;background:var(--bg);color:#fff;font:16px system-ui}main{max-width:1100px;margin:auto;padding:12px}#n{display:flex;gap:5px;overflow:auto;margin-bottom:10px;border-bottom:2px solid var(--line)}button{min-height:35px;padding:8px 10px;border:1px solid #8fa6c8;border-radius:8px;background:#263754;color:#fff}button.on{background:var(--accent)}button:disabled{opacity:.7}#n button{border:0;background:0;color:#fff;white-space:nowrap;font-weight:700}#s{display:grid;grid-template-columns:repeat(12,1fr);gap:10px}.w{min-width:0;padding:13px;border:1px solid var(--line);border-radius:12px;background:var(--card)}.n{color:#fff;font-size:15px;font-weight:700}.v{margin-top:8px;color:#fff;font-size:23px;font-weight:800;word-break:break-word}.binding-values{display:grid;gap:4px;margin-top:9px;padding-top:7px;border-top:1px solid var(--line);font-size:13px;color:#dbeafe}input,select{width:100%;min-height:37px;margin-top:10px;border:1px solid #8fa6c8;border-radius:8px;padding:8px;background:#091323;color:#fff}.w>button{width:100%;margin-top:10px}.scan,.days{display:grid;gap:6px;margin-top:10px;color:#fff}.days{grid-template-columns:repeat(7,1fr)}.gauge,.progress{margin-top:10px}.gauge i,.progress i{display:block;height:12px;margin-top:8px;border-radius:9px;background:linear-gradient(90deg,var(--accent) var(--p),#0b1525 var(--p))}.net{width:100%;margin-top:6px;text-align:left}.check{display:block;margin-top:12px;color:#fff}#connection{padding:8px}#m{position:sticky;bottom:0;background:#172338;padding:12px}small{display:block}@media(max-width:600px){[data-widget]{grid-column:1/-1!important;grid-row:auto!important}}";
        static_assert(sizeof(asset) - 1U + 128U <= FLPROG_HTTP_SERVER_MAX_RESPONSE_BYTES,
            "FLProg WebUI: css exceeds HTTP response budget");
        flprogWebUiSendIdentity(value, "text/css", asset);
#endif // FLPROG_WEBUI_GZIP_ASSETS
    }

    static void FLPROG_WEBUI_HTTP_FLASH scanScript(FLProgNetworkHttpServer *value)
    {
                                                                                                                                                                        #if FLPROG_WEBUI_GZIP_ASSETS
        static const unsigned char assetGzip[] PROGMEM = {0x1f, 0x8b, 0x08, 0x00, 0x00, 0x00, 0x00, 0x00, 0x02, 0xff, 0x65, 0x52, 0x51,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 0x00, 0x00};
        static_assert(sizeof(assetGzip) + 192U <= FLPROG_HTTP_SERVER_MAX_RESPONSE_BYTES, "gzip response budget");
        flprogWebUiSendGzip(value, "application/javascript", assetGzip, sizeof(assetGzip));
#else
        static const char asset[] PROGMEM =
            "function C(w,x,d){let h=window._flpChart||(window._flpChart={}),r=w.max-w.min||1,c=document.createElement('canvas'),ctx=c.getContext('2d');c.width=260;c.height=70;c.style.cssText='width:100%;height:70px;margin-top:8px;background:#08101c';let series=[{id:w.channel,value:x,color:w.color||'#6ee7ff'}];(w.bindings||[]).filter(b=>b.role=='series1'||b.role=='series2').forEach(b=>series.push({id:b.channel,value:v[b.channel],color:b.role=='series1'?'#f59e0b':'#34d399'}));series.forEach(a=>{let q=h[a.id]||[];q.push(+a.value||0);q=q.slice(-24);h[a.id]=q;ctx.strokeStyle=a.color;ctx.beginPath();q.forEach((n,i)=>{let X=i*260/23,Y=66-62*(n-w.min)/r;i?ctx.lineTo(X,Y):ctx.moveTo(X,Y)});ctx.stroke()});d.append(c);return 1}";
        static_assert(sizeof(asset) - 1U + 128U <= FLPROG_HTTP_SERVER_MAX_RESPONSE_BYTES,
            "FLProg WebUI: scanScript exceeds HTTP response budget");
        flprogWebUiSendIdentity(value, "application/javascript", asset);
#endif // FLPROG_WEBUI_GZIP_ASSETS
    }

    static void FLPROG_WEBUI_HTTP_FLASH widgetScript(FLProgNetworkHttpServer *value)
    {
                                                                                                                                                                        #if FLPROG_WEBUI_GZIP_ASSETS
        static const unsigned char assetGzip[] PROGMEM = {0x1f, 0x8b, 0x08, 0x00, 0x00, 0x00, 0x00, 0x00, 0x02, 0xff, 0x85, 0x53, 0x4d,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 0x00, 0x00};
        static_assert(sizeof(assetGzip) + 192U <= FLPROG_HTTP_SERVER_MAX_RESPONSE_BYTES, "gzip response budget");
        flprogWebUiSendGzip(value, "application/javascript", assetGzip, sizeof(assetGzip));
#else
        static const char asset[] PROGMEM =
            "function V(w,x,s){let d=document.createElement('section'),target=(w.bindings||[]).find(b=>b.role==='setpoint')?.channel||w.channel,cv=v[target]===undefined?x:v[target];d.className='w';d.style.gridColumn=w.x+' / span '+w.w;d.style.gridRow=w.y+' / span '+w.h;d.style.borderColor=w.color||t.accent||'#475569';if(E(w,x,d)){s.append(d);return}d.innerHTML='<div class=n>'+e(w.icon)+' '+e(w.label)+'</div>';if(F(w,cv,d,target)){}else if(w.type==='wifi-scan'){S(d)}else if(w.type==='chart'){C(w,x,d)}else if(w.type==='slider'){let i=document.createElement('input');i.type='range';i.min=w.min;i.max=w.max;i.step=w.step;i.value=cv;i.onchange=()=>p(target,i.value,w);d.append(i)}else if(w.type==='switch'||w.type==='button'){let i=document.createElement('button');i.textContent=w.type==='button'?w.label:(cv?'Включено':'Выключено');i.onclick=()=>p(target,w.type==='button'?true:!cv,w);d.append(i)}else if(w.type==='static-text'){d.textContent=w.options||w.label}else if(!X(w,cv,d))d.innerHTML+='<div class=v>'+e(x)+' '+e(w.unit)+'</div>';H(w,d);s.append(d)}";
        static_assert(sizeof(asset) - 1U + 128U <= FLPROG_HTTP_SERVER_MAX_RESPONSE_BYTES, "HTTP asset exceeds response budget");
        flprogWebUiSendIdentity(value, "application/javascript", asset);
#endif // FLPROG_WEBUI_GZIP_ASSETS
    }

    // asset-route: loaderScript /flprog-webui/controls.js?part=loader
    static void FLPROG_WEBUI_HTTP_FLASH loaderScript(FLProgNetworkHttpServer *value)
    {
#if defined(FLPROG_HTTP_SERVER_HAS_FLASH_STREAM)
        // One immutable resource replaces the sequential CSS/JS requests.
        // The same 256-byte Flash stream queue handles the entire bundle.
        flprogWebUiSendBundle(value);
        return;
#endif
                                                                                                                                        #if FLPROG_WEBUI_GZIP_ASSETS
        static const unsigned char assetGzip[] PROGMEM = {0x1f, 0x8b, 0x08, 0x00, 0x00, 0x00, 0x00, 0x00, 0x02, 0xff, 0x85, 0x53, 0xcb,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 0x00, 0x00};
        static_assert(sizeof(assetGzip) + 192U <= FLPROG_HTTP_SERVER_MAX_RESPONSE_BYTES, "gzip response budget");
        flprogWebUiSendGzip(value, "application/javascript", assetGzip, sizeof(assetGzip));
#else
        static const char asset[] PROGMEM = "(async()=>{let p=['scan.js','controls.js','elements.js','widgets.js','boot-view.js','controls.js?part=enabled','controls.js?part=status','controls.js?part=polling','controls.js?part=notice-view','controls.js?part=notice-track','controls.js?part=notice-sync','controls.js?part=confirm','controls.js?part=commands','controls.js?part=pattern-parse','controls.js?part=pattern-match','controls.js?part=fields','controls.js?part=form-state','controls.js?part=form-apply','controls.js?part=groups','controls.js?part=navigation','controls.js?part=catalog','boot-init.js','boot.js'],v='webui175-0ad879ed016f',status=document.querySelector('#s');try{let css=document.createElement('style');css.textContent=await bootRead('/flprog-webui/app.css?v='+v,'default');document.head.append(css);for(let i=0;i<p.length;i++){let x=p[i];status.textContent='Загрузка интерфейса: '+Math.round(i*100/p.length)+'% ('+(i+1)+'/'+p.length+')';let body=await bootRead('/flprog-webui/'+x+(x.includes('?')?'&':'?')+'v='+v,'default'),e=document.createElement('script');e.textContent=body;document.head.append(e)}status.textContent='Ресурсы загружены: 100%. Чтение данных ПЛК…'}catch(e){status.textContent='Ошибка загрузки: '+e.message+'. Обновите страницу.'}})()";
        static_assert(sizeof(asset) - 1U + 128U <= FLPROG_HTTP_SERVER_MAX_RESPONSE_BYTES, "loader budget");
        flprogWebUiSendIdentity(value, "application/javascript", asset);
#endif // FLPROG_WEBUI_GZIP_ASSETS
    }

    // asset-route: patternParseScript /flprog-webui/controls.js?part=pattern-parse
    static void FLPROG_WEBUI_HTTP_FLASH patternParseScript(FLProgNetworkHttpServer *value)
    {
                                                                        #if FLPROG_WEBUI_GZIP_ASSETS
        static const unsigned char assetGzip[] PROGMEM = {0x1f, 0x8b, 0x08, 0x00, 0x00, 0x00, 0x00, 0x00, 0x02, 0xff, 0x85, 0x54, 0x6d,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 0x00, 0x00};
        static_assert(sizeof(assetGzip) + 192U <= FLPROG_HTTP_SERVER_MAX_RESPONSE_BYTES, "gzip response budget");
        flprogWebUiSendGzip(value, "application/javascript", assetGzip, sizeof(assetGzip));
#else
        static const char asset[] PROGMEM = "function patRange(a,b){let s='';for(let c=a;c<=b;c++)s+=String.fromCharCode(c);return s}function patternParse(p){if(typeof p!=='string'||p.length>63||/[^\\x20-\\x7e]/.test(p))throw Error('pattern');let i=p[0]==='^'?1:0,t=[],special='\\\\.^$[]{}()*+?|',digits='0123456789';function atom(cls=false){let c=p[i++];if(c==='\\\\'){c=p[i++];if(c==='d')return digits;if(c==='w')return patRange(65,90)+patRange(97,122)+digits+'_';if(c==='s')return ' \\t\\n\\r\\v\\f';if(!c||!(special+'-/').includes(c))throw Error('pattern');return c}if(!c||(!cls&&special.includes(c))||(cls&&c==='['))throw Error('pattern');return c}while(i<p.length){if(p.slice(i)==='$'){i++;break}let chars='',lo=1,hi=1;if(p[i]==='['){i++;let neg=p[i]==='^';if(neg)i++;while(i<p.length&&p[i]!==']'){let a=atom(true);if(p[i]==='-'&&p[i+1]&&p[i+1]!==']'){i++;let b=atom(true);if(a.length!==1||b.length!==1||a>b)throw Error('pattern');chars+=patRange(a.charCodeAt(0),b.charCodeAt(0))}else chars+=a}if(!chars||p[i++]!==']')throw Error('pattern');if(neg)chars=[...patRange(0,127)].filter(c=>!chars.includes(c)).join('')}else if(p[i]==='.'){i++;chars=patRange(0,127).replace('\\n','').replace('\\r','')}else chars=atom();if('?*+'.includes(p[i])&&p[i]){let q=p[i++];lo=q==='+'?1:0;hi=q==='?'?1:63}else if(p[i]==='{'){let m=p.slice(i).match(/^\\{(\\d{1,2})(?:,(\\d{1,2}))?\\}/);if(!m)throw Error('pattern');lo=+m[1];hi=+(m[2]??m[1]);i+=m[0].length;if(lo>hi||hi>63)throw Error('pattern')}t.push([chars,lo,hi])}return t}";
        static_assert(sizeof(asset) - 1U + 128U <= FLPROG_HTTP_SERVER_MAX_RESPONSE_BYTES, "pattern response budget");
        flprogWebUiSendIdentity(value, "application/javascript", asset);
#endif // FLPROG_WEBUI_GZIP_ASSETS
    }

    // asset-route: patternMatchScript /flprog-webui/controls.js?part=pattern-match
    static void FLPROG_WEBUI_HTTP_FLASH patternMatchScript(FLProgNetworkHttpServer *value)
    {
                                                                        #if FLPROG_WEBUI_GZIP_ASSETS
        static const unsigned char assetGzip[] PROGMEM = {0x1f, 0x8b, 0x08, 0x00, 0x00, 0x00, 0x00, 0x00, 0x02, 0xff, 0x6d, 0x52, 0xcf,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 0x00, 0x00};
        static_assert(sizeof(assetGzip) + 192U <= FLPROG_HTTP_SERVER_MAX_RESPONSE_BYTES, "gzip response budget");
        flprogWebUiSendGzip(value, "application/javascript", assetGzip, sizeof(assetGzip));
#else
        static const char asset[] PROGMEM = "function patternMatches(p,value){if(!p)return true;if(value.length>63||/[^\\x00-\\x7f]/.test(value))return false;let positions=new Set([0]);try{for(let [chars,lo,hi]of patternParse(p)){let out=new Set();for(let start of positions){if(lo===0)out.add(start);let end=start;for(let count=1;count<=hi&&end<value.length;count++){if(!chars.includes(value[end]))break;end++;if(count>=lo)out.add(end)}}positions=out}return positions.has(value.length)}catch(e){return false}}function fieldValid(w,i){i.setCustomValidity?.('');let ok=i.checkValidity()&&new TextEncoder().encode(i.value).length<=(w.maxLength||63)&&!(i.type==='number'&&i.value==='')&&patternMatches(w.pattern,i.value);if(!ok)i.setCustomValidity?.(w.validationMessage||'Проверьте формат, диапазон, шаг и длину');return ok}";
        static_assert(sizeof(asset) - 1U + 128U <= FLPROG_HTTP_SERVER_MAX_RESPONSE_BYTES, "pattern response budget");
        flprogWebUiSendIdentity(value, "application/javascript", asset);
#endif // FLPROG_WEBUI_GZIP_ASSETS
    }

    // asset-route: enabledScript /flprog-webui/controls.js?part=enabled
    static void FLPROG_WEBUI_HTTP_FLASH enabledScript(FLProgNetworkHttpServer *value)
    {
                                                                                                #if FLPROG_WEBUI_GZIP_ASSETS
        static const unsigned char assetGzip[] PROGMEM = {0x1f, 0x8b, 0x08, 0x00, 0x00, 0x00, 0x00, 0x00, 0x02, 0xff, 0x9d, 0x52, 0x4d,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 0x00, 0x00};
        static_assert(sizeof(assetGzip) + 192U <= FLPROG_HTTP_SERVER_MAX_RESPONSE_BYTES, "gzip response budget");
        flprogWebUiSendGzip(value, "application/javascript", assetGzip, sizeof(assetGzip));
#else
        static const char asset[] PROGMEM = "function enabledBlocked(w){let b=w?.bindings?.find(b=>b.role==='enabled');return !!b&&v[b.channel]!==true}function O(w){let b=w?.bindings?.find(b=>b.role==='busy');return (!!b&&v[b.channel]===true)||enabledBlocked(w)}function gateMessage(w){return enabledBlocked(w)?'Нет разрешения ПЛК':'Команда уже выполняется'}function gateCheck(w){if(O(w))throw Error(gateMessage(w))}function gateLabels(){for(let d of document.querySelectorAll('[data-widget]')){let w=a.find(w=>w?.id===d.dataset.widget),b=w?.bindings?.find(b=>b.role==='enabled');if(!b)continue;let label=d.querySelector('[data-enabled]');if(!label){label=document.createElement('small');label.dataset.enabled='1';label.setAttribute('role','status');d.append(label)}label.textContent='Разрешение ПЛК: '+(v[b.channel]===true?'да':v[b.channel]===false?'нет':'нет данных');for(let i of d.querySelectorAll('button,input,select'))i.title=enabledBlocked(w)?'Нет разрешения ПЛК':''}}";
        static_assert(sizeof(asset) - 1U + 128U <= FLPROG_HTTP_SERVER_MAX_RESPONSE_BYTES, "enabled response budget");
        flprogWebUiSendIdentity(value, "application/javascript", asset);
#endif // FLPROG_WEBUI_GZIP_ASSETS
    }

    // asset-route: navigationScript /flprog-webui/controls.js?part=navigation
    static void FLPROG_WEBUI_HTTP_FLASH navigationScript(FLProgNetworkHttpServer *value)
    {
                                                                                                        #if FLPROG_WEBUI_GZIP_ASSETS
        static const unsigned char assetGzip[] PROGMEM = {0x1f, 0x8b, 0x08, 0x00, 0x00, 0x00, 0x00, 0x00, 0x02, 0xff, 0x75, 0x53, 0xcd,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 0x00, 0x00};
        static_assert(sizeof(assetGzip) + 192U <= FLPROG_HTTP_SERVER_MAX_RESPONSE_BYTES, "gzip response budget");
        flprogWebUiSendGzip(value, "application/javascript", assetGzip, sizeof(assetGzip));
#else
        static const char asset[] PROGMEM = "var navBusy=false,navReady=false,navKey='';function navStore(value){try{if(value!==undefined)localStorage.setItem(navKey,value);return localStorage.getItem(navKey)}catch(e){return null}}function navError(e,retry){M('Ошибка загрузки: '+e.message);let b=document.createElement('button');b.textContent='Повторить чтение';b.onclick=retry;document.querySelector('#m').append(b)}async function navSelect(x){if(navBusy||commandBusy)return;navBusy=true;navReady=false;pollStop();pollEpoch++;syncPending=true;needFull=true;let changed=g!==x.id;g=x.id;loadedPage='';v={};N(false);[...document.querySelector('#n').children].forEach((b,i)=>b.className=n[i].id===g?'on':'');try{await L(x);if(changed)R(true);loadStage('Синхронизация с ПЛК…');navReady=true;navBusy=false;await q();navStore(g);pollStarted=true;pollSchedule();if(!syncPending)M('')}catch(e){navError(e,()=>navSelect(x))}finally{navBusy=false}}";
        static_assert(sizeof(asset) - 1U + 128U <= FLPROG_HTTP_SERVER_MAX_RESPONSE_BYTES, "navigation response budget");
        flprogWebUiSendIdentity(value, "application/javascript", asset);
#endif // FLPROG_WEBUI_GZIP_ASSETS
    }

    // asset-route: pollingScript /flprog-webui/controls.js?part=polling
    static void FLPROG_WEBUI_HTTP_FLASH pollingScript(FLProgNetworkHttpServer *value)
    {
                                                                                                                #if FLPROG_WEBUI_GZIP_ASSETS
        static const unsigned char assetGzip[] PROGMEM = {0x1f, 0x8b, 0x08, 0x00, 0x00, 0x00, 0x00, 0x00, 0x02, 0xff, 0x6d, 0x52, 0x4d,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 0x00, 0x00};
        static_assert(sizeof(assetGzip) + 192U <= FLPROG_HTTP_SERVER_MAX_RESPONSE_BYTES, "gzip response budget");
        flprogWebUiSendGzip(value, "application/javascript", assetGzip, sizeof(assetGzip));
#else
        static const char asset[] PROGMEM = "var pollInterval=1300,pauseHidden=true,pollTimer=0,pollEpoch=0,syncPending=true,pollStarted=false;function pollBlocked(){return (typeof navReady!=='undefined'&&!navReady)||(typeof navBusy!=='undefined'&&navBusy)||syncPending||(pauseHidden&&document.hidden)}function pollStop(){clearTimeout(pollTimer);pollTimer=0}function pollSchedule(ms=pollInterval){pollStop();if(!pauseHidden||!document.hidden)pollTimer=setTimeout(async()=>{let epoch=pollEpoch;await q();if(epoch===pollEpoch)pollSchedule()},ms)}function pollConfig(m){let p=m.polling||{};pollInterval=Math.max(500,Math.min(60000,Number(p.intervalMs)||1300));pauseHidden=p.pauseWhenHidden!==false;freshWindow=Math.max(5000,pollInterval*3);syncPending=true}function pollChanged(){if(!pollStarted)return;if(document.hidden&&!pauseHidden)return;pollStop();pollEpoch++;needFull=true;syncPending=true;if(document.hidden){if(typeof noticePending!=='undefined')for(let p of [...noticePending])noticeEnd(p,'Опрос приостановлен. Подтверждение неизвестно; команда не повторяется.','error')}else{M('Синхронизация с ПЛК…');pollSchedule(0)}N(false)}document.addEventListener('visibilitychange',pollChanged);";
        static_assert(sizeof(asset) - 1U + 128U <= FLPROG_HTTP_SERVER_MAX_RESPONSE_BYTES, "polling budget");
        flprogWebUiSendIdentity(value, "application/javascript", asset);
#endif // FLPROG_WEBUI_GZIP_ASSETS
    }

    // asset-route: statusScript /flprog-webui/controls.js?part=status
    static void FLPROG_WEBUI_HTTP_FLASH statusScript(FLProgNetworkHttpServer *value)
    {
                                                                                                                                                                        #if FLPROG_WEBUI_GZIP_ASSETS
        static const unsigned char assetGzip[] PROGMEM = {0x1f, 0x8b, 0x08, 0x00, 0x00, 0x00, 0x00, 0x00, 0x02, 0xff, 0x95, 0x55, 0x5f,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 0x00, 0x00};
        static_assert(sizeof(assetGzip) + 192U <= FLPROG_HTTP_SERVER_MAX_RESPONSE_BYTES, "gzip response budget");
        flprogWebUiSendGzip(value, "application/javascript", assetGzip, sizeof(assetGzip));
#else
        static const char asset[] PROGMEM =
            "var lastOK=0,commandBusy=false,requestTail=Promise.resolve();function pollFreshWindow(){return typeof freshWindow==='number'?freshWindow:5000}function N(ok){if(ok)lastOK=Date.now();let b=document.querySelector('#connection');if(!b){b=document.createElement('div');b.id='connection';b.setAttribute('role','status');document.querySelector('main').prepend(b)}let age=lastOK?Math.floor((Date.now()-lastOK)/1000):null;b.textContent=(typeof pollBlocked==='function'&&pollBlocked()?(pauseHidden&&document.hidden?'● Опрос приостановлен':'● Синхронизация с ПЛК…'):(lastOK&&age*1000<pollFreshWindow()?'● На связи':'● Нет свежих данных')+(age===null?'':' · обновлено '+age+' с назад'));b.style.color=lastOK&&age*1000<pollFreshWindow()?'#6ee7b7':'#fca5a5';document.querySelectorAll('#s button,#s input,#s select').forEach(i=>i.disabled=(typeof pollBlocked==='function'&&pollBlocked())||commandBusy||!lastOK||age*1000>=pollFreshWindow()||O(a.find(w=>w?.id===i.closest('[data-widget]')?.dataset.widget)));if(typeof gateLabels==='function')gateLabels()}function f(u,o,sent){let task=async()=>{if((!o||!o.method||o.method==='GET')&&typeof bootRead==='function')return JSON.parse(await bootRead(u));let c=new AbortController(),timer=setTimeout(()=>c.abort(),4500);try{if(o?.method&&o.method!=='GET'&&typeof pollBlocked==='function'&&pollBlocked())throw Error('Команда не отправлена: синхронизация или пауза');if(sent)sent();let r=await fetch(u,{...o,signal:c.signal,cache:'no-store'}),d=await r.json();if(!r.ok)throw Error(d.error||'HTTP '+r.status);return d}finally{clearTimeout(timer)}};let next=requestTail.then(task,task);requestTail=next.catch(()=>{});return next}setInterval(()=>N(false),1000);";
        static_assert(sizeof(asset) - 1U + 128U <= FLPROG_HTTP_SERVER_MAX_RESPONSE_BYTES, "HTTP asset exceeds response budget");
        flprogWebUiSendIdentity(value, "application/javascript", asset);
#endif // FLPROG_WEBUI_GZIP_ASSETS
    }

    // asset-route: commandScript /flprog-webui/controls.js?part=commands
    static void FLPROG_WEBUI_HTTP_FLASH commandScript(FLProgNetworkHttpServer *value)
    {
                                                                                                                                                                        #if FLPROG_WEBUI_GZIP_ASSETS
        static const unsigned char assetGzip[] PROGMEM = {0x1f, 0x8b, 0x08, 0x00, 0x00, 0x00, 0x00, 0x00, 0x02, 0xff, 0xad, 0x54, 0xcd,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 0x00, 0x00};
        static_assert(sizeof(assetGzip) + 192U <= FLPROG_HTTP_SERVER_MAX_RESPONSE_BYTES, "gzip response budget");
        flprogWebUiSendGzip(value, "application/javascript", assetGzip, sizeof(assetGzip));
#else
        static const char asset[] PROGMEM =
            "var freshWindow=5000;async function p(k,value,w){if(commandBusy||!lastOK||Date.now()-lastOK>=freshWindow||(typeof pollBlocked==='function'&&pollBlocked())){M('Нет связи или ожидается ответ');if(typeof noticeInfo==='function')noticeInfo('Нет связи или ожидается ответ');return false}w=w||a.find(x=>x?.id===document.activeElement?.closest('[data-widget]')?.dataset.widget);if(O(w)){M(gateMessage(w));if(typeof noticeInfo==='function')noticeInfo(lastMessage);return false}commandBusy=true;N(false);let notification;const notices=typeof noticeStart==='function';try{if(w?.confirmation){M('Подтвердите команду');if(!await K(w.confirmation)){M('Команда отменена');if(notices)noticeInfo('Команда отменена','info');return false}}if(Date.now()-lastOK>=freshWindow||(typeof pollBlocked==='function'&&pollBlocked()))throw Error('Нет свежих данных');gateCheck(w);M('Отправка…');if(notices)notification=noticeStart(k,value,w);let d=await f('/flprog-webui/write?channel='+encodeURIComponent(k)+'&value='+encodeURIComponent(value)+(w?'&widget='+encodeURIComponent(w.id):''),{method:'POST'},()=>{gateCheck(w);if(notices)noticeSent(notification)});if(d.queued!==true)throw Error('Нет подтверждения приёма');if(notices)noticeAck(notification);M('Принято контроллером: '+(w?.label||k)+'. FBD: busy/result.');await q();return true}catch(x){M(x.name==='AbortError'?'Ответ не получен; результат неизвестен. Проверьте состояние перед повтором.':x.message);if(notices)noticeFail(notification,lastMessage);return false}finally{commandBusy=false;N(false)}}";
        static_assert(sizeof(asset) - 1U + 128U <= FLPROG_HTTP_SERVER_MAX_RESPONSE_BYTES, "HTTP asset exceeds response budget");
        flprogWebUiSendIdentity(value, "application/javascript", asset);
#endif // FLPROG_WEBUI_GZIP_ASSETS
    }

    // asset-route: fieldScript /flprog-webui/controls.js?part=fields
    static void FLPROG_WEBUI_HTTP_FLASH fieldScript(FLProgNetworkHttpServer *value)
    {
                                                                                                                                                                        #if FLPROG_WEBUI_GZIP_ASSETS
        static const unsigned char assetGzip[] PROGMEM = {0x1f, 0x8b, 0x08, 0x00, 0x00, 0x00, 0x00, 0x00, 0x02, 0xff, 0x75, 0x52, 0xc1,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 0x00, 0x00};
        static_assert(sizeof(assetGzip) + 192U <= FLPROG_HTTP_SERVER_MAX_RESPONSE_BYTES, "gzip response budget");
        flprogWebUiSendGzip(value, "application/javascript", assetGzip, sizeof(assetGzip));
#else
        static const char asset[] PROGMEM =
            "function F(w,x,d,target){if(!/^(text|password|number|color|date|time)-input$/.test(w.type))return false;let i=document.createElement('input'),b=document.createElement('button'),type=w.type.split('-')[0];i.type=type;i.value=type==='password'?'':(x??'');i.placeholder=w.placeholder||'';i.setAttribute('aria-label',w.label);i.maxLength=w.maxLength||63;if(type==='number'){i.min=w.min;i.max=w.max;i.step=w.step}b.textContent='Применить';d.append(i,b);if(w.unit){let unit=document.createElement('small');unit.textContent=w.unit;d.append(unit)}T(w,i,b,d,target);return true}";
        static_assert(sizeof(asset) - 1U + 128U <= FLPROG_HTTP_SERVER_MAX_RESPONSE_BYTES, "HTTP asset exceeds response budget");
        flprogWebUiSendIdentity(value, "application/javascript", asset);
#endif // FLPROG_WEBUI_GZIP_ASSETS
    }

    // asset-route: groupScript /flprog-webui/controls.js?part=groups
    static void FLPROG_WEBUI_HTTP_FLASH groupScript(FLProgNetworkHttpServer *value)
    {
                                                                                                                                                                        #if FLPROG_WEBUI_GZIP_ASSETS
        static const unsigned char assetGzip[] PROGMEM = {0x1f, 0x8b, 0x08, 0x00, 0x00, 0x00, 0x00, 0x00, 0x02, 0xff, 0x85, 0x54, 0xdb,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 0x00, 0x00};
        static_assert(sizeof(assetGzip) + 192U <= FLPROG_HTTP_SERVER_MAX_RESPONSE_BYTES, "gzip response budget");
        flprogWebUiSendGzip(value, "application/javascript", assetGzip, sizeof(assetGzip));
#else
        static const char asset[] PROGMEM =
            "function groupAppearance(shell,grid,c){c=c||{border:true,padding:12,gap:10};shell.style.cssText='grid-column:1/-1;border:'+(c.border?'1px solid #7186a8':'0')+';padding:'+c.padding+'px;border-radius:12px';grid.style.cssText='display:grid;grid-template-columns:repeat(12,minmax(0,1fr));gap:'+c.gap+'px'}function R(reset){let s=document.querySelector('#s');if(s.dataset.page!==g){s.replaceChildren();s.dataset.page=g}let groups=new Map();for(let w of a.filter(w=>w.page===g)){let parent=s,name=(w.group||'').trim();if(name){parent=groups.get(name);if(!parent){parent=[...s.children].find(d=>d.dataset.group===name)?.lastElementChild;if(!parent){let shell=document.createElement('section'),h=document.createElement('h2');shell.dataset.group=name;h.textContent=name;parent=document.createElement('div');shell.append(h,parent);s.append(shell)}groupAppearance(parent.parentElement,parent,w.groupStyle);groups.set(name,parent)}}let old=[...parent.children].find(d=>d.dataset.widget===w.id),x=v[(w.bindings||[]).find(b=>b.role==='value')?.channel||w.channel],sig=JSON.stringify([x,...(w.bindings||[]).map(b=>v[b.channel])]);if(old?._sync){old._sync(reset);old._signature=sig;continue}if(old&&(old.dataset.dirty||old.contains(document.activeElement)||w.type==='wifi-scan'||(w.type!=='chart'&&old._signature===sig)))continue;let holder=document.createElement('div');V(w,x,holder);let next=holder.firstElementChild;next.dataset.widget=w.id;next._signature=sig;if(old)old.replaceWith(next);else parent.append(next)}}";
        static_assert(sizeof(asset) - 1U + 128U <= FLPROG_HTTP_SERVER_MAX_RESPONSE_BYTES, "HTTP asset exceeds response budget");
        flprogWebUiSendIdentity(value, "application/javascript", asset);
#endif // FLPROG_WEBUI_GZIP_ASSETS
    }

    // asset-route: formStateScript /flprog-webui/controls.js?part=form-state
    static void FLPROG_WEBUI_HTTP_FLASH formStateScript(FLProgNetworkHttpServer *value)
    {
                                                                                                                                                                        #if FLPROG_WEBUI_GZIP_ASSETS
        static const unsigned char assetGzip[] PROGMEM = {0x1f, 0x8b, 0x08, 0x00, 0x00, 0x00, 0x00, 0x00, 0x02, 0xff, 0x8d, 0x53, 0xdd,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 0x00, 0x00};
        static_assert(sizeof(assetGzip) + 192U <= FLPROG_HTTP_SERVER_MAX_RESPONSE_BYTES, "gzip response budget");
        flprogWebUiSendGzip(value, "application/javascript", assetGzip, sizeof(assetGzip));
#else
        static const char asset[] PROGMEM =
            "function T(w,i,b,d,target){let st=document.createElement('small'),fact=document.createElement('small'),source=w.bindings?.find(b=>b.role==='value')?.channel||w.channel;st.setAttribute('role','status');st.setAttribute('aria-label','Состояние поля '+w.label);d.append(st,fact);let state=t=>{st.textContent=t;d.dataset.fieldState=t};state('Синхронизировано');d._sync=reset=>{let x=v[source];fact.textContent=i.type==='password'?'Значение ПЛК: скрыто':'Значение ПЛК: '+(x??'нет данных')+' '+(w.unit||'');if(!d.dataset.dirty&&(reset||document.activeElement!==i)){i.value=i.type==='password'?'':(v[target]??x??'');if(reset)state('Синхронизировано')}};i.oninput=()=>{d.dataset.dirty='1';state('Есть изменения')};b.onclick=()=>A(w,i,d,target,state);i.onkeydown=e=>{if(e.key==='Enter'){e.preventDefault();b.onclick()}if(e.key==='Escape'){delete d.dataset.dirty;d._sync(true);i.blur()}};d._sync(false)}";
        static_assert(sizeof(asset) - 1U + 128U <= FLPROG_HTTP_SERVER_MAX_RESPONSE_BYTES, "HTTP asset exceeds response budget");
        flprogWebUiSendIdentity(value, "application/javascript", asset);
#endif // FLPROG_WEBUI_GZIP_ASSETS
    }

    // asset-route: formApplyScript /flprog-webui/controls.js?part=form-apply
    static void FLPROG_WEBUI_HTTP_FLASH formApplyScript(FLProgNetworkHttpServer *value)
    {
                                                                                                                                                                        #if FLPROG_WEBUI_GZIP_ASSETS
        static const unsigned char assetGzip[] PROGMEM = {0x1f, 0x8b, 0x08, 0x00, 0x00, 0x00, 0x00, 0x00, 0x02, 0xff, 0x5d, 0x52, 0x3d,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 0x00, 0x00};
        static_assert(sizeof(assetGzip) + 192U <= FLPROG_HTTP_SERVER_MAX_RESPONSE_BYTES, "gzip response budget");
        flprogWebUiSendGzip(value, "application/javascript", assetGzip, sizeof(assetGzip));
#else
        static const char asset[] PROGMEM =
            "async function A(w,i,d,target,state){if(commandBusy)return;if(!fieldValid(w,i)){state(w.validationMessage||'Ошибка: проверьте формат, диапазон, шаг и длину');if(typeof noticeInfo==='function')noticeInfo('Ошибка ввода: '+w.label);i.reportValidity();return}d.dataset.dirty='1';state('Отправляется…');if(await p(target,i.value,w)){delete d.dataset.dirty;if(i.type==='password')i.value='';state('Принято контроллером')}else state(lastMessage==='Команда отменена'?'Есть изменения':'Ошибка: '+lastMessage);d._sync(false)}";
        static_assert(sizeof(asset) - 1U + 128U <= FLPROG_HTTP_SERVER_MAX_RESPONSE_BYTES, "HTTP asset exceeds response budget");
        flprogWebUiSendIdentity(value, "application/javascript", asset);
#endif // FLPROG_WEBUI_GZIP_ASSETS
    }

    // asset-route: confirmScript /flprog-webui/controls.js?part=confirm
    static void FLPROG_WEBUI_HTTP_FLASH confirmScript(FLProgNetworkHttpServer *value)
    {
                                                                                                                                                                #if FLPROG_WEBUI_GZIP_ASSETS
        static const unsigned char assetGzip[] PROGMEM = {0x1f, 0x8b, 0x08, 0x00, 0x00, 0x00, 0x00, 0x00, 0x02, 0xff, 0x55, 0x51, 0x6d,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 0x00, 0x00};
        static_assert(sizeof(assetGzip) + 192U <= FLPROG_HTTP_SERVER_MAX_RESPONSE_BYTES, "gzip response budget");
        flprogWebUiSendGzip(value, "application/javascript", assetGzip, sizeof(assetGzip));
#else
        static const char asset[] PROGMEM =
            "function K(text){return new Promise(ok=>{let d=document.createElement('dialog');d.setAttribute('aria-label','Подтверждение команды');d.style.cssText='max-width:420px;background:#172338;color:white;border:1px solid #8fa6c8;border-radius:12px;padding:20px';d.innerHTML='<p></p><button>Отмена</button> <button>Отправить</button>';d.firstChild.textContent=text;let done=v=>{d.close();d.remove();ok(v)};d.querySelectorAll('button').forEach((b,i)=>b.onclick=()=>done(!!i));d.oncancel=e=>{e.preventDefault();done(false)};document.body.append(d);d.showModal()})}";
        static_assert(sizeof(asset)-1U+128U <= FLPROG_HTTP_SERVER_MAX_RESPONSE_BYTES, "notification asset budget");
        flprogWebUiSendIdentity(value, "application/javascript", asset);
#endif // FLPROG_WEBUI_GZIP_ASSETS
    }

    // asset-route: notice_viewScript /flprog-webui/controls.js?part=notice-view
    static void FLPROG_WEBUI_HTTP_FLASH notice_viewScript(FLProgNetworkHttpServer *value)
    {
                                                                                                                                                                #if FLPROG_WEBUI_GZIP_ASSETS
        static const unsigned char assetGzip[] PROGMEM = {0x1f, 0x8b, 0x08, 0x00, 0x00, 0x00, 0x00, 0x00, 0x02, 0xff, 0x7d, 0x54, 0x41,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 0x00, 0x00};
        static_assert(sizeof(assetGzip) + 192U <= FLPROG_HTTP_SERVER_MAX_RESPONSE_BYTES, "gzip response budget");
        flprogWebUiSendGzip(value, "application/javascript", assetGzip, sizeof(assetGzip));
#else
        static const char asset[] PROGMEM =
            "var noticeCards=[],noticePending=[],noticeLost=false;function noticeView(label){let box=document.querySelector('#notices');if(!box){box=document.createElement('aside');box.id='notices';box.setAttribute('aria-label','Уведомления');box.setAttribute('aria-live','polite');box.style.cssText='position:fixed;right:12px;bottom:12px;width:min(360px,94vw);max-height:55vh;overflow:auto;z-index:40';document.body.append(box)}let card=document.createElement('article'),head=document.createElement('b'),close=document.createElement('button');card.style.cssText='background:#172338;color:white;border:1px solid #8fa6c8;border-radius:10px;padding:12px;margin-top:8px;box-shadow:0 4px 14px #0008';head.textContent=label;close.textContent='×';close.setAttribute('aria-label','Закрыть уведомление');close.style.cssText='float:right;min-height:24px;padding:0 8px';close.onclick=()=>card.remove();card.append(close,head);box.append(card);noticeCards.push(card);while(noticeCards.length>5)noticeCards.shift().remove();return card}function noticeStep(card,text,kind='info'){if(!card)return;let line=document.createElement('p');line.textContent=text;line.style.margin='6px 0 0';card.append(line);card.dataset.stage=kind;card.style.borderColor=kind==='error'?'#fca5a5':kind==='confirmed'?'#6ee7b7':'#8fa6c8';if(card.parentElement)card.parentElement.scrollTop=card.parentElement.scrollHeight;if(kind==='confirmed'||kind==='info')setTimeout(()=>card.remove(),12000)}function noticeInfo(text,kind='error'){let card=noticeView(kind==='error'?'Ошибка':'Сообщение');noticeStep(card,text,kind);return card}";
        static_assert(sizeof(asset)-1U+128U <= FLPROG_HTTP_SERVER_MAX_RESPONSE_BYTES, "notification asset budget");
        flprogWebUiSendIdentity(value, "application/javascript", asset);
#endif // FLPROG_WEBUI_GZIP_ASSETS
    }

    // asset-route: notice_trackScript /flprog-webui/controls.js?part=notice-track
    static void FLPROG_WEBUI_HTTP_FLASH notice_trackScript(FLProgNetworkHttpServer *value)
    {
                                                                                                                                                                #if FLPROG_WEBUI_GZIP_ASSETS
        static const unsigned char assetGzip[] PROGMEM = {0x1f, 0x8b, 0x08, 0x00, 0x00, 0x00, 0x00, 0x00, 0x02, 0xff, 0x8d, 0x54, 0xcd,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 0x00, 0x00};
        static_assert(sizeof(assetGzip) + 192U <= FLPROG_HTTP_SERVER_MAX_RESPONSE_BYTES, "gzip response budget");
        flprogWebUiSendGzip(value, "application/javascript", assetGzip, sizeof(assetGzip));
#else
        static const char asset[] PROGMEM =
            "function noticeStart(channel,value,w){let key=w?.id||channel;for(let p of noticePending.filter(p=>p.key===key))noticeEnd(p,'Заменено новой командой','info');let bindings=w?.bindings||[],feedback=bindings.find(b=>b.role==='value')?.channel||w?.channel||channel,result=bindings.find(b=>b.role==='result')?.channel,busy=bindings.find(b=>b.role==='busy')?.channel;let p={key,channel,value,feedback,result,busy,before:v[result],seenBusy:false,accepted:false,password:w?.type==='password-input',card:noticeView(w?.label||channel)};noticePending.push(p);noticeStep(p.card,'Отправляется…','sending');p.timer=setTimeout(()=>{if(noticePending.includes(p))noticeEnd(p,'Подтверждение данными не получено за 30 с. Команда не повторяется.','error')},30000);return p}function noticeSent(p){if(p){if(!noticePending.includes(p))throw Error('Команда не отправлена: ожидание отменено');noticeStep(p.card,'Отправлено','sent')}}function noticeAck(p){if(p&&noticePending.includes(p)){p.accepted=true;noticeStep(p.card,'Принято контроллером','accepted')}}function noticeEnd(p,text,kind){noticePending=noticePending.filter(x=>x!==p);clearTimeout(p.timer);noticeStep(p.card,text,kind)}function noticeFail(p,text){if(p)noticeEnd(p,'Ошибка: '+text,'error');else noticeInfo(text)}";
        static_assert(sizeof(asset)-1U+128U <= FLPROG_HTTP_SERVER_MAX_RESPONSE_BYTES, "notification asset budget");
        flprogWebUiSendIdentity(value, "application/javascript", asset);
#endif // FLPROG_WEBUI_GZIP_ASSETS
    }

    // asset-route: notice_syncScript /flprog-webui/controls.js?part=notice-sync
    static void FLPROG_WEBUI_HTTP_FLASH notice_syncScript(FLProgNetworkHttpServer *value)
    {
                                                                                                                                                                #if FLPROG_WEBUI_GZIP_ASSETS
        static const unsigned char assetGzip[] PROGMEM = {0x1f, 0x8b, 0x08, 0x00, 0x00, 0x00, 0x00, 0x00, 0x02, 0xff, 0x85, 0x53, 0xcd,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 0x00, 0x00};
        static_assert(sizeof(assetGzip) + 192U <= FLPROG_HTTP_SERVER_MAX_RESPONSE_BYTES, "gzip response budget");
        flprogWebUiSendGzip(value, "application/javascript", assetGzip, sizeof(assetGzip));
#else
        static const char asset[] PROGMEM =
            "function noticeSame(actual,expected){if(typeof actual==='number')return Number.isFinite(Number(expected))&&Math.abs(actual-Number(expected))<=.00051+Math.abs(actual)*.000001;if(typeof actual==='boolean')return actual===(expected===true||expected==='true'||expected===1||expected==='1');return actual!==undefined&&actual===String(expected)}function noticeSync(reset){if(noticeLost){noticeLost=false;noticeInfo('Связь восстановлена','info')}for(let p of [...noticePending]){if(reset){noticeEnd(p,'ПЛК перезапущен. Подтверждение команды неизвестно.','error');continue}if(!p.accepted)continue;let channel=p.feedback,confirmed=false;if(p.result){channel=p.result;let hasResult=Object.hasOwn(v,channel),changed=hasResult&&v[channel]!==p.before;if(p.busy&&v[p.busy]===true)p.seenBusy=true;confirmed=hasResult&&(p.busy?(v[p.busy]===false&&(p.seenBusy||changed)):changed)}else confirmed=noticeSame(v[channel],p.value);if(confirmed)noticeEnd(p,'Подтверждено данными: '+channel+' = '+(p.password?'скрыто':String(v[channel])),'confirmed')}}function noticeOffline(){if(noticeLost)return;noticeLost=true;for(let p of [...noticePending])noticeEnd(p,'Связь прервалась. Результат неизвестен; команда не повторяется.','error');noticeInfo('Нет связи с ПЛК. Данные не обновляются.')}";
        static_assert(sizeof(asset)-1U+128U <= FLPROG_HTTP_SERVER_MAX_RESPONSE_BYTES, "notification asset budget");
        flprogWebUiSendIdentity(value, "application/javascript", asset);
#endif // FLPROG_WEBUI_GZIP_ASSETS
    }

    static void FLPROG_WEBUI_HTTP_FLASH controlScript(FLProgNetworkHttpServer *value)
    {
        if (value->hasArgumentKey("part")) {
            const String part = value->argumentValueAtKey("part");
            if (part == "pattern-parse") { patternParseScript(value); return; }
            if (part == "pattern-match") { patternMatchScript(value); return; }
            if (part == "enabled") { enabledScript(value); return; }
            if (part == "navigation") { navigationScript(value); return; }
            if (part == "polling") { pollingScript(value); return; }
            if (part == "loader") { loaderScript(value); return; }
            if (part == "catalog") { catalogScript(value); return; }
            if (part == "notice-sync") { notice_syncScript(value); return; }
            if (part == "notice-track") { notice_trackScript(value); return; }
            if (part == "notice-view") { notice_viewScript(value); return; }
            if (part == "confirm") { confirmScript(value); return; }
            if (part == "status") { statusScript(value); return; }
            if (part == "commands") { commandScript(value); return; }
            if (part == "fields") { fieldScript(value); return; }
            if (part == "form-apply") { formApplyScript(value); return; }
            if (part == "form-state") { formStateScript(value); return; }
            if (part == "groups") { groupScript(value); return; }
            value->send(404, "application/json", "{}"); return;
        }
                                                                                                                                                                        #if FLPROG_WEBUI_GZIP_ASSETS
        static const unsigned char assetGzip[] PROGMEM = {0x1f, 0x8b, 0x08, 0x00, 0x00, 0x00, 0x00, 0x00, 0x02, 0xff, 0x95, 0x54, 0x41,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 0x00, 0x00};
        static_assert(sizeof(assetGzip) + 192U <= FLPROG_HTTP_SERVER_MAX_RESPONSE_BYTES, "gzip response budget");
        flprogWebUiSendGzip(value, "application/javascript", assetGzip, sizeof(assetGzip));
#else
        static const char asset[] PROGMEM =
            "function X(w,x,d){let k=w.type,i,z=Math.max(0,Math.min(100,100*(x-w.min)/(w.max-w.min||1))),target=(w.bindings||[]).find(b=>b.role=='setpoint')?.channel||w.channel;if(I(w,x,d)||G(w,x,d))return 1;if(k=='radial-gauge'){d.innerHTML+='<div style=\"width:88px;height:88px;padding:25px 0;text-align:center;border-radius:50%;background:conic-gradient('+w.color+' '+z+'%,#0b1525 0)\">'+e(x)+'</div>';return 1}if(k=='battery'){d.innerHTML+='<div style=\"margin-top:10px;border:2px solid '+w.color+';padding:3px\"><i style=\"display:block;height:22px;width:'+z+'%;background:'+w.color+'\"></i></div>';return 1}if(k=='segment-display'){d.innerHTML+='<div style=\"margin-top:10px;padding:8px;background:#050805;color:#7cff9c;font:28px monospace;letter-spacing:3px\">'+e(x)+'</div>';return 1}if(k=='traffic-light'){d.innerHTML+='<div style=\"margin-top:10px;width:32px;height:32px;border-radius:50%;background:'+(x?'#36d399':'#ef4444')+'\"></div>';return 1}if(k=='checkbox'){i=document.createElement('label');i.className='check';i.innerHTML='<input type=checkbox '+(x?'checked':'')+'> Включено';i.firstChild.onchange=()=>p(target,i.firstChild.checked)}else if(k=='weekdays'){i=document.createElement('div');i.className='days';'Пн Вт Ср Чт Пт Сб Вс'.split(' ').forEach((z,n)=>{let b=document.createElement('button');b.textContent=z;b.className=(x&(1<<n))?'on':'';b.onclick=()=>p(target,(x^(1<<n)));i.append(b)})}else if(k=='select'){i=document.createElement('select');(w.options||'').split(';').forEach(z=>{let o=document.createElement('option');o.value=z;o.textContent=z;o.selected=z==x;i.append(o)});i.onchange=()=>p(target,i.value)}else return 0;d.append(i);return 1}";
        static_assert(sizeof(asset) - 1U + 128U <= FLPROG_HTTP_SERVER_MAX_RESPONSE_BYTES, "HTTP asset exceeds response budget");
        flprogWebUiSendIdentity(value, "application/javascript", asset);
#endif // FLPROG_WEBUI_GZIP_ASSETS
    }

    static void FLPROG_WEBUI_HTTP_FLASH bootScript(FLProgNetworkHttpServer *value)
    {
                                                                                                                                                                        #if FLPROG_WEBUI_GZIP_ASSETS
        static const unsigned char assetGzip[] PROGMEM = {0x1f, 0x8b, 0x08, 0x00, 0x00, 0x00, 0x00, 0x00, 0x02, 0xff, 0xa5, 0x55, 0xcb,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 0x00, 0x00};
        static_assert(sizeof(assetGzip) + 192U <= FLPROG_HTTP_SERVER_MAX_RESPONSE_BYTES, "gzip response budget");
        flprogWebUiSendGzip(value, "application/javascript", assetGzip, sizeof(assetGzip));
#else
        static const char asset[] PROGMEM =
            "var a=[],t={},g='',n=[],v={},busy=0,rv=0,loadedPage='',stamp=0,needFull=true,lastMessage='';function e(v){let x=document.createElement('span');x.textContent=v==null?'':v;return x.innerHTML}function M(v){lastMessage=v;let x=document.querySelector('#m');x.setAttribute('role','status');x.textContent=v;x.hidden=!v}async function q(){if((typeof navReady!=='undefined'&&!navReady)||(typeof navBusy!=='undefined'&&navBusy)||busy||(typeof pauseHidden==='boolean'&&pauseHidden&&document.hidden))return;let epoch=typeof pollEpoch==='number'?pollEpoch:0;busy=1;let page=g,full=needFull||loadedPage!==g,hadData=loadedPage===g;try{let u='/flprog-webui/state?page='+encodeURIComponent(page),d=await f(u+(full?'':'&since='+rv));function valid(d){if(!d.values||typeof d.values!=='object'||typeof d.revision!=='number')throw Error('invalid state')}valid(d);let reset=d.revision<rv||(typeof d.uptime==='number'&&d.uptime<stamp);if(!full&&reset){d=await f(u);valid(d);full=true}if(page!==g||(typeof pollEpoch==='number'&&epoch!==pollEpoch))return;if(full)v={};rv=d.revision;stamp=d.uptime??stamp;Object.assign(v,d.values);loadedPage=page;needFull=false;R(reset||(full&&hadData));if(typeof syncPending==='boolean')syncPending=false;N(true);if(typeof loadStageDone==='function')loadStageDone();if(typeof noticeSync==='function')noticeSync(reset);if(full&&hadData)M('Значения ПЛК синхронизированы; черновики сохранены')}catch(x){needFull=true;if(typeof syncPending==='boolean')syncPending=true;N(false);if(!(typeof pauseHidden==='boolean'&&pauseHidden&&document.hidden)&&typeof noticeOffline==='function')noticeOffline()}finally{busy=0;if(typeof pollEpoch==='number'&&epoch!==pollEpoch&&!document.hidden)pollSchedule(0)}}setTimeout(B,350)";
        static_assert(sizeof(asset) - 1U + 128U <= FLPROG_HTTP_SERVER_MAX_RESPONSE_BYTES, "HTTP asset exceeds response budget");
        flprogWebUiSendIdentity(value, "application/javascript", asset);
#endif // FLPROG_WEBUI_GZIP_ASSETS
    }

    static void FLPROG_WEBUI_HTTP_FLASH bootViewScript(FLProgNetworkHttpServer *value)
    {
                                                                                                                                                                        #if FLPROG_WEBUI_GZIP_ASSETS
        static const unsigned char assetGzip[] PROGMEM = {0x1f, 0x8b, 0x08, 0x00, 0x00, 0x00, 0x00, 0x00, 0x02, 0xff, 0x7d, 0x52, 0xdd,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 0x00, 0x00};
        static_assert(sizeof(assetGzip) + 192U <= FLPROG_HTTP_SERVER_MAX_RESPONSE_BYTES, "gzip response budget");
        flprogWebUiSendGzip(value, "application/javascript", assetGzip, sizeof(assetGzip));
#else
        static const char asset[] PROGMEM =
            "function I(w,x,d){let z=100*(x-w.min)/(w.max-w.min||1),c=w.color||'#7367ff';z=Math.max(0,Math.min(100,z));if(w.type=='sector-gauge'){d.innerHTML+='<i style=\"display:block;width:100px;height:50px;margin:8px auto;padding-top:27px;text-align:center;border-radius:100px 100px 0 0;background:conic-gradient(from 270deg,'+c+' '+z+'%,#091323 0 50%,transparent 0)\">'+e(x)+'</i>';return 1}if(w.type=='bar-meter'){d.innerHTML+='<b style=\"display:block;height:38px;margin-top:8px;background:'+c+';clip-path:inset('+(100-z)+'% 0 0)\"></b>';return 1}}function G(w,x,d){let k=w.type,z=Math.max(0,Math.min(100,100*(x-w.min)/(w.max-w.min||1)));if(k=='gauge'||k=='progress'){d.innerHTML+='<div class='+k+'><b>'+e(x)+'</b><i style=\"--p:'+z+'%\"></i></div>';return 1}return 0}";
        static_assert(sizeof(asset) - 1U + 128U <= FLPROG_HTTP_SERVER_MAX_RESPONSE_BYTES,
            "FLProg WebUI: bootViewScript exceeds HTTP response budget");
        flprogWebUiSendIdentity(value, "application/javascript", asset);
#endif // FLPROG_WEBUI_GZIP_ASSETS
    }


    static void FLPROG_WEBUI_HTTP_FLASH elementScript(FLProgNetworkHttpServer *value)
    {
                                                                                                                                                                        #if FLPROG_WEBUI_GZIP_ASSETS
        static const unsigned char assetGzip[] PROGMEM = {0x1f, 0x8b, 0x08, 0x00, 0x00, 0x00, 0x00, 0x00, 0x02, 0xff, 0x85, 0x53, 0xb1,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 0x00, 0x00};
        static_assert(sizeof(assetGzip) + 192U <= FLPROG_HTTP_SERVER_MAX_RESPONSE_BYTES, "gzip response budget");
        flprogWebUiSendGzip(value, "application/javascript", assetGzip, sizeof(assetGzip));
#else
        static const char asset[] PROGMEM =
            "function E(w,x,d){if(w.type=='heading'){d.className+=' el head';d.innerHTML='<h1>'+e(w.label)+'</h1>';return 1}if(w.type=='divider'){d.className+=' el div';d.innerHTML='<hr>';return 1}if(w.type=='link'){d.className+=' el lnk';let a=document.createElement('a');a.href=w.options||'#';a.textContent=w.label||w.options;d.append(a);return 1}if(w.type=='status-row'){d.className+=' el row';d.innerHTML='<span>'+e(w.label)+'</span><b>'+e(x===undefined||x===null||x===''?(w.placeholder||''):x)+'</b>';return 1}if(w.code){d.innerHTML='<div class=n>'+e(w.icon)+' '+e(w.label)+'</div>';d.innerHTML+='<div class=v>'+w.code.replace(/{{label}}/g,e(w.label)).replace(/{{value}}/g,e(x)).replace(/{{icon}}/g,e(w.icon))+'</div>';return 1}return 0}function H(w,d){let extras=(w.bindings||[]).filter(b=>['alarm','busy','result'].includes(b.role));if(extras.length){let info=document.createElement('div');info.className='binding-values';extras.forEach(b=>{let row=document.createElement('div');let value=v[b.channel];row.textContent=({busy:'Выполняется',result:'Выполнено',alarm:'Авария'})[b.role]+': '+(value===undefined?'нет данных':typeof value==='boolean'?(value?'да':'нет'):value);info.append(row)});d.append(info)}}";
        static_assert(sizeof(asset) - 1U + 128U <= FLPROG_HTTP_SERVER_MAX_RESPONSE_BYTES,
            "FLProg WebUI: elementScript exceeds HTTP response budget");
        flprogWebUiSendIdentity(value, "application/javascript", asset);
#endif // FLPROG_WEBUI_GZIP_ASSETS
    }


    // asset-route: catalogScript /flprog-webui/controls.js?part=catalog
    static void FLPROG_WEBUI_HTTP_FLASH catalogScript(FLProgNetworkHttpServer *value)
    {
                        #if FLPROG_WEBUI_GZIP_ASSETS
        static const unsigned char assetGzip[] PROGMEM = {0x1f, 0x8b, 0x08, 0x00, 0x00, 0x00, 0x00, 0x00, 0x02, 0xff, 0xa5, 0x52, 0xcb,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 0x00, 0x00};
        static_assert(sizeof(assetGzip) + 192U <= FLPROG_HTTP_SERVER_MAX_RESPONSE_BYTES, "gzip response budget");
        flprogWebUiSendGzip(value, "application/javascript", assetGzip, sizeof(assetGzip));
#else
        static const char asset[] PROGMEM = "var loadStageMessage='';function loadStageDone(){if(lastMessage===loadStageMessage)M('');loadStageMessage=''}function loadStage(text){loadStageMessage=text;let s=document.querySelector('#s');if(!s.dataset.page)s.textContent=text;M(text)}async function L(x){if(!x||x.loaded)return;let items=[],ids=x.indices||[];if(x.widgetCatalog){loadStage('Чтение описаний элементов: '+ids.length+'…');let d=await f('/flprog-webui/item?widgets='+encodeURIComponent(x.id));if(d.page!==x.id||!Array.isArray(d.items)||d.items.length!==ids.length||d.items.some((r,j)=>!Array.isArray(r)||r.length!==2||r[0]!==ids[j]||!r[1]||r[1].page!==x.id||typeof r[1].id!=='string'||typeof r[1].type!=='string'))throw Error('Неполные описания элементов');items=d.items}else{for(let i of ids){loadStage('Чтение описаний элементов: '+(items.length+1)+'/'+ids.length);items.push([i,await f('/flprog-webui/item?index='+i)])}}for(let [i,w]of items)a[i]=w;x.loaded=1}";
        static_assert(sizeof(asset)-1U+128U <= FLPROG_HTTP_SERVER_MAX_RESPONSE_BYTES, "catalog bootstrap budget");
        flprogWebUiSendIdentity(value, "application/javascript", asset);
#endif // FLPROG_WEBUI_GZIP_ASSETS
    }

    static void FLPROG_WEBUI_HTTP_FLASH bootInitScript(FLProgNetworkHttpServer *value)
    {
                                                                                                                                                                        #if FLPROG_WEBUI_GZIP_ASSETS
        static const unsigned char assetGzip[] PROGMEM = {0x1f, 0x8b, 0x08, 0x00, 0x00, 0x00, 0x00, 0x00, 0x02, 0xff, 0x85, 0x53, 0xcd,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 0x00, 0x00};
        static_assert(sizeof(assetGzip) + 192U <= FLPROG_HTTP_SERVER_MAX_RESPONSE_BYTES, "gzip response budget");
        flprogWebUiSendGzip(value, "application/javascript", assetGzip, sizeof(assetGzip));
#else
        static const char asset[] PROGMEM =
            "async function B(){if(navBusy)return;navBusy=true;navReady=false;pollStop();pollStarted=false;syncPending=true;pollEpoch++;N(false);try{loadStage('Чтение списка страниц…');let m=await f('/flprog-webui/item?page=0'),pages=[m];for(let i=1;i<m.pages;i++)pages.push(await f('/flprog-webui/item?page='+i));n=pages;a=[];pollConfig(m);t=m.theme||{};navKey='flprog-page:'+location.pathname+JSON.stringify(n.map(x=>[x.id,x.title]));let x=n.find(x=>x.id===navStore())||n[0];let z=document.querySelector('#n');z.innerHTML=n.map(x=>'<button>'+e(x.title)+'</button>').join('');[...z.children].forEach((b,i)=>b.onclick=()=>navSelect(n[i]));let r=document.documentElement.style;for(let k of ['background','card','text','accent'])r.setProperty('--'+(k==='background'?'bg':k),t[k]||'');navBusy=false;await navSelect(x);if(typeof bootStarted==='number')document.querySelector('main').setAttribute('data-load-ms',Date.now()-bootStarted)}catch(e){navBusy=false;navError(e,B)}}";
        static_assert(sizeof(asset) - 1U + 128U <= FLPROG_HTTP_SERVER_MAX_RESPONSE_BYTES,
            "FLProg WebUI: bootInitScript exceeds HTTP response budget");
        flprogWebUiSendIdentity(value, "application/javascript", asset);
#endif // FLPROG_WEBUI_GZIP_ASSETS
    }

    static void FLPROG_WEBUI_HTTP_FLASH scanStart(FLProgNetworkHttpServer *value)
    {
        if (!active() || !active()->network || !FLProgNetworkInterface::platformCapabilities().wifiScanCompiled)
        {
            value->send(501, "application/json", "{\"error\":\"Wi-Fi scan is unavailable\"}");
            return;
        }
        if (!active()->network->startWifiScan(false))
        {
            value->send(409, "application/json", "{\"error\":\"scan busy\"}");
            return;
        }
        value->send(202, "application/json", "{\"queued\":true}");
    }

    static void FLPROG_WEBUI_HTTP_FLASH scan(FLProgNetworkHttpServer *value)
    {
        if (!active() || !active()->network) { value->send(503, "application/json", "{}"); return; }
        if (value->hasArgumentKey("index"))
        {
            const unsigned index = strtoul(value->argumentValueAtKey("index").c_str(), 0, 10);
            const int16_t count = active()->network->wifiScanCount();
            if (index > 255 || index >= (unsigned)(count > 0 ? count : 0)) { value->send(404, "application/json", "{}"); return; }
            Json json(active()->buffer, sizeof(active()->buffer));
            const String ssid = active()->network->wifiScanSsid((uint8_t)index);
            json.text("{\"ssid\":"); json.string(ssid.c_str());
            json.text(",\"rssi\":"); json.signedNumber(active()->network->wifiScanRssi((uint8_t)index));
            json.text(",\"channel\":"); json.signedNumber(active()->network->wifiScanChannel((uint8_t)index));
            json.text(",\"secure\":"); json.text(active()->network->wifiScanEncryption((uint8_t)index) ? "true" : "false");
            json.character('}');
            sendJson(value, json);
            return;
        }
        Json json(active()->buffer, sizeof(active()->buffer));
        const int16_t total = active()->network->wifiScanCount();
        const unsigned count = total <= 0 ? 0 : (total > 20 ? 20U : (unsigned)total);
        json.text("{\"running\":"); json.text(active()->network->wifiScanRunning() ? "true" : "false");
        json.text(",\"count\":"); json.unsignedNumber(count);
        json.text(",\"total\":"); json.unsignedNumber(total > 0 ? (unsigned)total : 0);
        json.text(",\"error\":"); json.unsignedNumber(active()->network->wifiScanLastError());
        json.character('}');
        sendJson(value, json);
    }

    static void FLPROG_WEBUI_HTTP_FLASH item(FLProgNetworkHttpServer *value)
    {
        if (!active()) { value->send(503, "application/json", "{}"); return; }
#if defined(FLPROG_WEBUI_WIDGET_CATALOG) && defined(FLPROG_HTTP_SERVER_HAS_FLASH_STREAM)
        if (value->hasArgumentKey("widgets")) {
            const String page = value->argumentValueAtKey("widgets");
            if (!FLPROG_WEBUI_WIDGET_CATALOG(value, page.c_str()))
                value->send(404, "application/json", "{\"error\":\"unknown page\"}");
            return;
        }
#endif
        if (value->hasArgumentKey("page"))
        {
            const unsigned index = strtoul(value->argumentValueAtKey("page").c_str(), 0, 10);
            const uint8_t count = active()->pageCount ? active()->pageCount : active()->derivedPageCount();
            if (index >= count) { value->send(404, "application/json", "{\"error\":\"unknown page\"}"); return; }
            const char *id = active()->pageCount ? active()->pages[index].id : active()->derivedPage((uint8_t)index);
            const char *title = active()->pageCount ? active()->pages[index].title : active()->friendlyTitle(id);
            Json json(active()->buffer, sizeof(active()->buffer));
            json.text("{\"id\":"); json.string(id); json.text(",\"title\":"); json.string(title);
            // Tell the browser exactly which small descriptor responses belong to
            // this page.  It can then defer other pages until the user opens them.
            json.text(",\"indices\":[");
            bool firstWidget = true;
            for (uint8_t widgetIndex = 0; widgetIndex < active()->widgetCount; ++widgetIndex)
            {
                const char *widgetPage = active()->widgets[widgetIndex].page ? active()->widgets[widgetIndex].page : "main";
                if (strcmp(widgetPage, id) != 0) continue;
                if (!firstWidget) json.character(',');
                json.unsignedNumber(widgetIndex);
                firstWidget = false;
            }
            json.character(']');
#if defined(FLPROG_WEBUI_WIDGET_CATALOG) && defined(FLPROG_HTTP_SERVER_HAS_FLASH_STREAM)
            json.text(",\"widgetCatalog\":true");
#endif
            if (index == 0)
            {
                const FLProgWebUiThemeDescriptor &currentTheme = active()->theme;
                json.text(",\"polling\":{\"intervalMs\":"); json.unsignedNumber(active()->_pollIntervalMs);
                json.text(",\"pauseWhenHidden\":"); json.text(active()->_pauseWhenHidden ? "true" : "false"); json.character('}');
                json.text(",\"widgets\":"); json.unsignedNumber(active()->widgetCount);
                json.text(",\"pages\":"); json.unsignedNumber(active()->pageCount ? active()->pageCount : active()->derivedPageCount());
                json.text(",\"theme\":{\"background\":"); json.string(currentTheme.background);
                json.text(",\"card\":"); json.string(currentTheme.card);
                json.text(",\"text\":"); json.string(currentTheme.text);
                json.text(",\"accent\":"); json.string(currentTheme.accent); json.character('}');
            }
            json.character('}');
            sendJson(value, json);
            return;
        }
        if (!value->hasArgumentKey("index")) { value->send(400, "application/json", "{\"error\":\"index required\"}"); return; }
        const unsigned index = strtoul(value->argumentValueAtKey("index").c_str(), 0, 10);
        if (index >= active()->widgetCount) { value->send(404, "application/json", "{\"error\":\"unknown widget\"}"); return; }
        const FLProgWebUiWidgetDescriptor &item = active()->widgets[index];
        Json json(active()->buffer, sizeof(active()->buffer));
        json.text("{\"id\":"); json.string(item.id);
        json.text(",\"group\":"); json.string(item.group);
        json.text(",\"placeholder\":"); json.string(item.placeholder);
        json.text(",\"unit\":"); json.string(item.unit);
        json.text(",\"maxLength\":"); json.unsignedNumber(item.maxLength ? item.maxLength : 63);
        json.text(",\"groupStyle\":"); json.text(item.groupStyle ? item.groupStyle : "{\"border\":true,\"padding\":12,\"gap\":10}");
        json.text(",\"pattern\":"); json.string(item.pattern ? item.pattern : "");
        json.text(",\"validationMessage\":"); json.string(item.validationMessage ? item.validationMessage : "");
        json.text(",\"confirmation\":"); json.string(item.confirmation ? item.confirmation : (strcmp(item.type, "button") == 0 ? "Отправить команду?" : ""));
        json.text(",\"type\":"); json.string(item.type); json.text(",\"label\":"); json.string(item.label);
        json.text(",\"channel\":"); json.string(item.channel); json.text(",\"icon\":"); json.string(item.icon);
        json.text(",\"color\":"); json.string(item.color); json.text(",\"page\":"); json.string(item.page ? item.page : "main"); json.text(",\"options\":"); json.string(item.options ? item.options : ""); json.text(",\"code\":"); json.string(item.code ? item.code : "");
        json.text(",\"bindings\":[");
        for (uint8_t i = 0; item.bindings && i < item.bindingCount; ++i)
        {
            if (i) json.character(',');
            json.text("{\"role\":"); json.string(item.bindings[i].role);
            json.text(",\"channel\":"); json.string(item.bindings[i].channel);
            json.text(",\"direction\":"); json.string(item.bindings[i].direction); json.character('}');
        }
        json.character(']');
        json.text(",\"min\":"); json.decimal(item.minimum); json.text(",\"max\":"); json.decimal(item.maximum); json.text(",\"step\":"); json.decimal(item.step);
        json.text(",\"x\":"); json.unsignedNumber(item.x); json.text(",\"y\":"); json.unsignedNumber(item.y);
        json.text(",\"w\":"); json.unsignedNumber(item.width); json.text(",\"h\":"); json.unsignedNumber(item.height); json.character('}');
        sendJson(value, json);
    }

    void FLPROG_WEBUI_HTTP_FLASH jsonValue(Json &json, uint8_t index)
    {
        switch (model.typeAt(index))
        {
            case FLPROG_WEBUI_BOOL: json.text(model.boolAt(index) ? "true" : "false"); break;
            case FLPROG_WEBUI_INT32: json.signedNumber(model.intAt(index)); break;
            case FLPROG_WEBUI_FLOAT: json.decimal(model.floatAt(index)); break;
            default: json.string(model.textAt(index)); break;
        }
    }

    bool FLPROG_WEBUI_HTTP_FLASH channelBefore(const char *page, const char *channel, uint8_t widgetIndex, uint8_t bindingIndex) const
    {
        for (uint8_t i = 0; i <= widgetIndex; ++i)
        {
            const FLProgWebUiWidgetDescriptor &previous = widgets[i];
            const char *previousPage = previous.page ? previous.page : "main";
            if (strcmp(previousPage, page) != 0) continue;
            if (previous.channel && strcmp(previous.channel, channel) == 0 && (i < widgetIndex || bindingIndex > 0)) return true;
            if (previous.bindings)
                for (uint8_t b = 0; b < previous.bindingCount; ++b)
                    if ((i < widgetIndex || b + 1 < bindingIndex) && strcmp(previous.bindings[b].channel, channel) == 0) return true;
        }
        return false;
    }

    void FLPROG_WEBUI_HTTP_FLASH statePage(FLProgNetworkHttpServer *value, const char *page, bool hasRevision, uint16_t since)
    {
        syncSystem();
        Json json(buffer, sizeof(buffer));
        json.text("{\"uptime\":"); json.unsignedNumber(millis());
        json.text(",\"revision\":"); json.unsignedNumber(model.revision()); json.text(",\"values\":{");
        bool first = true;
        for (uint8_t i = 0; i < widgetCount; ++i)
        {
            const FLProgWebUiWidgetDescriptor &widget = widgets[i];
            const char *widgetPage = widget.page ? widget.page : "main";
            if (strcmp(widgetPage, page) != 0 || strcmp(widget.type, "wifi-scan") == 0) continue;
            for (uint8_t b = 0; b <= widget.bindingCount; ++b)
            {
                const char *channel = b == 0 ? widget.channel : widget.bindings[b - 1].channel;
                if (!channel || strcmp(channel, "wifi_password") == 0 || strcmp(channel, "ap_password") == 0 || channelBefore(page, channel, i, b)) continue;
                const int16_t index = model.indexOf(channel);
                if (index < 0 || (hasRevision && !model.changedSince((uint8_t)index, since))) continue;
                if (!first) json.character(',');
                first = false;
                json.string(channel); json.character(':'); jsonValue(json, (uint8_t)index);
            }
        }
        json.text("}}");
        sendJson(value, json);
    }

    static void FLPROG_WEBUI_HTTP_FLASH state(FLProgNetworkHttpServer *value)
    {
        if (!active()) { value->send(503, "application/json", "{}"); return; }
        if (value->hasArgumentKey("page"))
        {
            const String page = value->argumentValueAtKey("page");
            const bool hasRevision = value->hasArgumentKey("since");
            const uint16_t since = hasRevision ? (uint16_t)strtoul(value->argumentValueAtKey("since").c_str(), 0, 10) : 0;
            active()->statePage(value, page.c_str(), hasRevision, since);
            return;
        }
        if (!value->hasArgumentKey("channel")) { value->send(404, "application/json", "{\"error\":\"unknown channel\"}"); return; }
        const String channel = value->argumentValueAtKey("channel");
        // Passwords are write-only: the browser can replace, never read them.
        if (channel == "wifi_password" || channel == "ap_password") { value->send(404, "application/json", "{\"error\":\"secret channel\"}"); return; }
        active()->syncSystem();
        if (!active()->api.stateOne(channel.c_str(), active()->buffer, sizeof(active()->buffer))) { value->send(404, "application/json", "{\"error\":\"unknown channel\"}"); return; }
        value->send(200, "application/json", active()->buffer);
    }

    // Reject repeats on the device too, including direct HTTP clients.
    bool FLPROG_WEBUI_HTTP_FLASH commandLocked(const char *channel) const {
        for (uint8_t i = 0; i < widgetCount; ++i) {
            const FLProgWebUiWidgetDescriptor &w = widgets[i];
            const char *target = w.channel;
            for (uint8_t b = 0; w.bindings && b < w.bindingCount; ++b)
                if (strcmp(w.bindings[b].role, "setpoint") == 0) target = w.bindings[b].channel;
            if (!target || strcmp(target, channel) != 0) continue;
            for (uint8_t b = 0; w.bindings && b < w.bindingCount; ++b) {
                const bool enabled = strcmp(w.bindings[b].role, "enabled") == 0;
                if (!enabled && strcmp(w.bindings[b].role, "busy") != 0) continue;
                const int16_t index = model.indexOf(w.bindings[b].channel);
                const bool valid = index >= 0 && model.typeAt((uint8_t)index) == FLPROG_WEBUI_BOOL;
                if (enabled && (!valid || model.directionAt((uint8_t)index) == FLPROG_WEBUI_COMMAND || !model.boolAt((uint8_t)index))) return true;
                if (!enabled && valid && model.boolAt((uint8_t)index)) return true;
            }
        }
        return false;
    }

    bool FLPROG_WEBUI_HTTP_FLASH validInput(const FLProgWebUiWidgetDescriptor &w, const char *channel, const char *input) const {
        const char *target = w.channel;
        for (uint8_t i = 0; w.bindings && i < w.bindingCount; ++i)
            if (strcmp(w.bindings[i].role, "setpoint") == 0) target = w.bindings[i].channel;
        if (!target || strcmp(target, channel) != 0) return false;
        if (strlen(input) > (w.maxLength ? w.maxLength : 63)) return false;
        if (!flprog_webui_pattern::matches(w.pattern,input)) return false;
        if (strcmp(w.type, "number-input") == 0 || strcmp(w.type, "slider") == 0) {
            char *end = 0;
            const double number = strtod(input, &end);
            if (!*input || end == input || *end || !isfinite(number) || number < w.minimum || number > w.maximum) return false;
            if (w.step > 0) {
                const double count = (number - w.minimum) / w.step;
                if (fabs(count - round(count)) > 0.001) return false;
            }
        }
        return true;
    }

    static void FLPROG_WEBUI_HTTP_FLASH fieldError(FLProgNetworkHttpServer *value,const FLProgWebUiWidgetDescriptor *w) {
        Json json(active()->buffer,sizeof(active()->buffer)); json.text("{\"error\":");
        json.string(w && w->validationMessage && *w->validationMessage ? w->validationMessage : "invalid field value"); json.character('}');
        if(json.good()) value->send(422,"application/json",active()->buffer); else value->send(422,"application/json","{\"error\":\"invalid field value\"}");
    }
    static void FLPROG_WEBUI_HTTP_FLASH write(FLProgNetworkHttpServer *value)
    {
        if (!active() || !value->hasArgumentKey("channel") || !value->hasArgumentKey("value")) { value->send(400, "application/json", "{\"error\":\"channel and value required\"}"); return; }
        const String channel = value->argumentValueAtKey("channel");
        const String input = value->argumentValueAtKey("value");
        if(input.length()!=strlen(input.c_str())) { fieldError(value,0); return; }
        if(channel=="device_model" || channel=="firmware_version") { value->send(422,"application/json","{\"error\":\"readonly identity\"}"); return; }
        if(FLProgWebUiPlatformDiagnostics::readonlyChannel(channel.c_str())) { value->send(422,"application/json","{\"error\":\"readonly diagnostics\"}"); return; }
        if (active()->commandLocked(channel.c_str())) {
            value->send(409, "application/json", "{\"error\":\"Управление заблокировано: busy/enabled\"}"); return;
        }
        if (value->hasArgumentKey("widget")) {
            const String id = value->argumentValueAtKey("widget");
            const FLProgWebUiWidgetDescriptor *widget = 0;
            for (uint8_t i = 0; i < active()->widgetCount; ++i)
                if (id == active()->widgets[i].id) { widget = &active()->widgets[i]; break; }
            if (!widget || !active()->validInput(*widget, channel.c_str(), input.c_str())) {
                fieldError(value,widget); return;
            }
        }
        for(uint8_t i=0;i<active()->widgetCount;++i) {
            const FLProgWebUiWidgetDescriptor &w=active()->widgets[i];
            if(!w.pattern || !*w.pattern) continue;
            const char *target=w.channel;
            for(uint8_t b=0;w.bindings && b<w.bindingCount;++b) if(strcmp(w.bindings[b].role,"setpoint")==0) target=w.bindings[b].channel;
            if(target && channel==target && !active()->validInput(w,channel.c_str(),input.c_str())) { fieldError(value,&w); return; }
        }
        if (!active()->api.write(channel.c_str(), input.c_str())) { value->send(422, "application/json", "{\"error\":\"invalid value or readonly channel\"}"); return; }
        if (active()->network && channel == "wifi_ssid") active()->network->setClientSsid(input);
        if (active()->network && channel == "wifi_password") active()->network->setClientPassword(input);
        if (channel == "network_apply" && !active()->applyStaSettings()) { value->send(422, "application/json", "{\"error\":\"invalid static IP settings\"}"); return; }
        if (channel == "ap_apply" && !active()->applyApSettings()) { value->send(422, "application/json", "{\"error\":\"invalid access point settings\"}"); return; }
        if (channel == "wifi_scan" && (!active()->network || !active()->network->startWifiScan(false))) { value->send(409, "application/json", "{\"error\":\"scan busy or unavailable\"}"); return; }
        value->send(202, "application/json", "{\"queued\":true}");
    }

    static const FLProgWebUiThemeDescriptor &FLPROG_WEBUI_HTTP_FLASH defaultTheme()
    {
        static const FLProgWebUiThemeDescriptor value = {"#0b1120", "#162237", "#edf3ff", "#7367ff"};
        return value;
    }

    const char *FLPROG_WEBUI_HTTP_FLASH derivedPage(uint8_t index) const
    {
        uint8_t found = 0;
        for (uint8_t i = 0; i < widgetCount; ++i)
        {
            const char *id = widgets[i].page ? widgets[i].page : "main";
            bool known = false;
            for (uint8_t previous = 0; previous < i; ++previous)
                if (strcmp(widgets[previous].page ? widgets[previous].page : "main", id) == 0) { known = true; break; }
            if (!known && found++ == index) return id;
        }
        return "main";
    }

    uint8_t FLPROG_WEBUI_HTTP_FLASH derivedPageCount() const
    {
        uint8_t count = 0;
        for (uint8_t i = 0; i < widgetCount; ++i)
        {
            const char *id = widgets[i].page ? widgets[i].page : "main";
            bool known = false;
            for (uint8_t previous = 0; previous < i; ++previous)
                if (strcmp(widgets[previous].page ? widgets[previous].page : "main", id) == 0) { known = true; break; }
            if (!known) ++count;
        }
        return count;
    }

    const char *FLPROG_WEBUI_HTTP_FLASH friendlyTitle(const char *id) const
    {
        if (strcmp(id, "main") == 0) return "Главная";
        if (strcmp(id, "wifi") == 0) return "Wi‑Fi";
        if (strcmp(id, "access-point") == 0) return "Точка доступа";
        if (strcmp(id, "wifi-scanner") == 0) return "Сканер Wi‑Fi";
        return id;
    }

    void FLPROG_WEBUI_HTTP_FLASH publishText(const char *id, const String &value)
    {
        const int16_t index = model.indexOf(id);
        if (index >= 0) model.publishText((uint8_t)index, value.c_str());
    }

    bool FLPROG_WEBUI_HTTP_FLASH parseIp(const char *input, IPAddress &ip)
    {
        unsigned a, b, c, d;
        char trailing;
        if (!input || sscanf(input, "%u.%u.%u.%u%c", &a, &b, &c, &d, &trailing) != 4 || a > 255 || b > 255 || c > 255 || d > 255) return false;
        ip = IPAddress(a, b, c, d);
        return true;
    }

    bool FLPROG_WEBUI_HTTP_FLASH applyStaSettings()
    {
        if (!network) return false;
        const int16_t dhcpIndex = model.indexOf("network_dhcp");
        const bool dhcp = dhcpIndex >= 0 && model.boolAt((uint8_t)dhcpIndex);
        if (!dhcp)
        {
            IPAddress ip, gateway, subnet, dns;
            int16_t index = model.indexOf("network_ip_config"); if (index < 0 || !parseIp(model.textAt((uint8_t)index), ip)) return false;
            index = model.indexOf("network_gateway_config"); if (index < 0 || !parseIp(model.textAt((uint8_t)index), gateway)) return false;
            index = model.indexOf("network_subnet_config"); if (index < 0 || !parseIp(model.textAt((uint8_t)index), subnet)) return false;
            index = model.indexOf("network_dns"); if (index < 0 || !parseIp(model.textAt((uint8_t)index), dns)) return false;
            network->resetDhcp(); network->localIP(ip); network->gateway(gateway); network->subnet(subnet); network->dns(dns);
        }
        else network->setDhcp();
        network->disconnect();
        network->connect();
        settingsLoaded = false;
        return true;
    }

    bool FLPROG_WEBUI_HTTP_FLASH applyApSettings()
    {
        if (!network || !FLProgNetworkInterface::platformCapabilities().wifiApCompiled) return false;
        int16_t index = model.indexOf("ap_ssid");
        if (index < 0) return false;
        const String ssid = model.textAt((uint8_t)index);
        if (ssid.length() == 0 || ssid.length() > 32) return false;
        IPAddress ip, gateway, subnet;
        index = model.indexOf("ap_ip"); if (index < 0 || !parseIp(model.textAt((uint8_t)index), ip)) return false;
        index = model.indexOf("ap_gateway"); if (index < 0 || !parseIp(model.textAt((uint8_t)index), gateway)) return false;
        index = model.indexOf("ap_subnet"); if (index < 0 || !parseIp(model.textAt((uint8_t)index), subnet)) return false;
        const int16_t passwordIndex = model.indexOf("ap_password");
        const String password = passwordIndex < 0 ? String() : String(model.textAt((uint8_t)passwordIndex));
        if (password.length() && (password.length() < 8 || password.length() > 63)) return false;
        const int16_t channelIndex = model.indexOf("ap_channel"), clientsIndex = model.indexOf("ap_max_clients");
        const int16_t hiddenIndex = model.indexOf("ap_hidden"), enabledIndex = model.indexOf("ap_enabled");
        const uint8_t channel = channelIndex < 0 ? 1 : (uint8_t)model.intAt((uint8_t)channelIndex);
        const uint8_t clients = clientsIndex < 0 ? 4 : (uint8_t)model.intAt((uint8_t)clientsIndex);
        if (channel < 1 || channel > 13 || clients < 1 || clients > FLProgNetworkInterface::accessPointMaxClientsLimit()) return false;
        network->setAccessPointSsid(ssid);
        // Blank means “keep existing”: a password is never published or read.
        if (password.length()) network->setAccessPointPassword(password);
        network->setAccessPointChannel(channel);
        network->setAccessPointHidden(hiddenIndex >= 0 && model.boolAt((uint8_t)hiddenIndex));
        network->setAccessPointMaxClients(clients);
        network->setAccessPointIP(ip); network->setAccessPointGateway(gateway); network->setAccessPointSubnet(subnet);
        network->accessPointMode(enabledIndex >= 0 && model.boolAt((uint8_t)enabledIndex));
        apSettingsLoaded = false;
        return true;
    }

    void FLPROG_WEBUI_HTTP_FLASH syncSystem()
    {
        if (!network) return;
        syncPlatformDiagnostics();
        publishText("network_ip", network->localIP().toString());
#if defined(FLPROG_NETWORK_HAS_ACTIVE_IP_INFO)
        if (model.indexOf("network_gateway") >= 0) publishText("network_gateway", network->activeGateway().toString());
        if (model.indexOf("network_subnet") >= 0) publishText("network_subnet", network->activeSubnet().toString());
#else
        publishText("network_gateway", network->gateway().toString());
        publishText("network_subnet", network->subnet().toString());
#endif
        publishText("wifi_ssid", network->clientSsid());
#if defined(FLPROG_NETWORK_HAS_DEVICE_IDENTITY)
        int16_t identityIndex=model.indexOf("device_model");
        if(identityIndex>=0) model.publishText((uint8_t)identityIndex,network->deviceModel());
        identityIndex=model.indexOf("firmware_version");
        if(identityIndex>=0) model.publishText((uint8_t)identityIndex,network->firmwareVersion());
#endif
        int16_t index = model.indexOf("network_ready"); if (index >= 0) model.publishBool((uint8_t)index, network->isReady());
        index = model.indexOf("wifi_rssi"); if (index >= 0) model.publishInt((uint8_t)index, network->rssi());
        uint8_t *mac = network->mac(); char macText[18];
        snprintf(macText, sizeof(macText), "%02X:%02X:%02X:%02X:%02X:%02X", mac[0], mac[1], mac[2], mac[3], mac[4], mac[5]);
        publishText("network_mac", String(macText));
        if (!settingsLoaded)
        {
            publishText("network_ip_config", network->localIP().toString());
            publishText("network_gateway_config", network->gateway().toString());
            publishText("network_subnet_config", network->subnet().toString());
            publishText("network_dns", network->dns().toString());
            index = model.indexOf("network_dhcp"); if (index >= 0) model.publishBool((uint8_t)index, network->isDhcp());
            settingsLoaded = true;
        }
        if (!FLProgNetworkInterface::platformCapabilities().wifiApCompiled) return;
        index = model.indexOf("ap_ready"); if (index >= 0) model.publishBool((uint8_t)index, network->accessPointIsReady());
        index = model.indexOf("ap_station_count"); if (index >= 0) model.publishInt((uint8_t)index, network->accessPointStationCount());
        index = model.indexOf("ap_pending"); if (index >= 0) model.publishBool((uint8_t)index, network->accessPointConfigurationPending());
        index = model.indexOf("ap_error"); if (index >= 0) model.publishInt((uint8_t)index, network->accessPointLastError());
        publishText("ap_live_ip", network->accessPointIP().toString());
        if (!apSettingsLoaded)
        {
            publishText("ap_ssid", network->accessPointSsid());
            publishText("ap_ip", network->accessPointConfiguredIP().toString());
            publishText("ap_gateway", network->accessPointConfiguredGateway().toString());
            publishText("ap_subnet", network->accessPointConfiguredSubnet().toString());
            index = model.indexOf("ap_enabled"); if (index >= 0) model.publishBool((uint8_t)index, network->accessPointMode());
            index = model.indexOf("ap_channel"); if (index >= 0) model.publishInt((uint8_t)index, network->accessPointChannel());
            index = model.indexOf("ap_hidden"); if (index >= 0) model.publishBool((uint8_t)index, network->accessPointHidden());
            index = model.indexOf("ap_max_clients"); if (index >= 0) model.publishInt((uint8_t)index, network->accessPointMaxClients());
            apSettingsLoaded = true;
        }
    }

    void FLPROG_WEBUI_HTTP_FLASH syncPlatformDiagnostics()
    {
        int16_t uptimeIndex=model.indexOf("system_uptime");
        if(uptimeIndex>=0) model.publishInt((uint8_t)uptimeIndex,(int32_t)(millis()/1000UL));
        int16_t flagsIndex=model.indexOf("reset_flags"), causeIndex=model.indexOf("reset_cause");
        int16_t usedIndex=model.indexOf("heap_used"), freeIndex=model.indexOf("heap_arena_free");
        char text[12];
        if(flagsIndex>=0 || causeIndex>=0) {
            uint32_t flags;
            bool available=FLProgWebUiPlatformDiagnostics::readResetFlags(flags);
            if(flagsIndex>=0) {
                if(available) snprintf(text,sizeof(text),"0x%08lX",(unsigned long)flags);
                model.publishText((uint8_t)flagsIndex,available?text:"");
            }
            if(causeIndex>=0) model.publishText((uint8_t)causeIndex,available?FLProgWebUiPlatformDiagnostics::resetDescription(flags):"");
        }
        if(usedIndex>=0 || freeIndex>=0) {
            int32_t used,free;
            bool available=FLProgWebUiPlatformDiagnostics::readHeap(used,free);
            if(usedIndex>=0) {
                if(available) snprintf(text,sizeof(text),"%ld",(long)used);
                model.publishText((uint8_t)usedIndex,available?text:"");
            }
            if(freeIndex>=0) {
                if(available) snprintf(text,sizeof(text),"%ld",(long)free);
                model.publishText((uint8_t)freeIndex,available?text:"");
            }
        }
        const char *memoryIds[]={"flash_total","flash_app_capacity","flash_app_used","flash_app_free","ram_total","ram_app_capacity","ram_static_used","ram_available_estimate","ram_used_estimate","ccm_total","ccm_used"};
        bool wanted=false;
        for(const char *id:memoryIds) if(model.indexOf(id)>=0) {wanted=true;break;}
        if(wanted) {
            const auto m=FLProgWebUiPlatformDiagnostics::readMemory();
            publishMeasurement("flash_total",m.physicalFlash,m.flashTotal);
            publishMeasurement("flash_app_capacity",m.flashLayout,m.flashCapacity);
            publishMeasurement("flash_app_used",m.flashLayout,m.flashUsed);
            publishMeasurement("flash_app_free",m.flashLayout,m.flashCapacity-m.flashUsed);
            publishMeasurement("ram_total",m.physicalRam,m.ramTotal);
            publishMeasurement("ram_app_capacity",m.ramLayout,m.ramCapacity);
            publishMeasurement("ram_static_used",m.ramLayout,m.ramStatic);
            publishMeasurement("ram_available_estimate",m.availableEstimate,m.ramAvailable);
            publishMeasurement("ram_used_estimate",m.availableEstimate,m.ramCapacity-m.ramAvailable);
            publishMeasurement("ccm_total",m.ccm,m.ccmTotal);
            publishMeasurement("ccm_used",false,0); // No linker/runtime ownership contract for CCM yet.
        }
    }

    void FLPROG_WEBUI_HTTP_FLASH publishMeasurement(const char *id,bool available,uint32_t value)
    {
        int16_t index=model.indexOf(id); if(index<0)return;
        char text[12]; if(available)snprintf(text,sizeof(text),"%lu",(unsigned long)value);
        model.publishText((uint8_t)index,available?text:"");
    }

    FLProgWebUiModel &model;
    FLProgWebUiHttpProtocol api;
    const FLProgWebUiWidgetDescriptor *widgets;
    uint8_t widgetCount;
    const FLProgWebUiPageDescriptor *pages;
    uint8_t pageCount;
    const FLProgWebUiThemeDescriptor &theme;
    FLProgNetworkInterface *network;
    uint32_t _pollIntervalMs = 1300;
    bool _pauseWhenHidden = true;
    bool settingsLoaded;
    bool apSettingsLoaded;
    FLProgNetworkHttpServer server;
    char buffer[FLPROG_WEBUI_FLPROG_HTTP_BUFFER_SIZE];
};
#undef FLPROG_WEBUI_HTTP_FLASH
#undef FLPROG_WEBUI_HTTP_STRINGIFY
#undef FLPROG_WEBUI_HTTP_STRINGIFY_INNER
